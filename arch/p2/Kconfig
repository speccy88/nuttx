## arch/p2/Kconfig
```kconfig
if ARCH_P2

comment "Parallax Propeller 2 Options"

choice
	prompt "P2 chip selection"
	default ARCH_CHIP_P2X8C4M64P

config ARCH_CHIP_P2X8C4M64P
	bool "P2X8C4M64P"
	select ARCH_HAVE_RESET
	select ARCH_HAVE_RNG
	select ARCH_HAVE_UDELAY
	select ARCH_HAVE_DYNAMIC_UDELAY
	select UART0_SERIALDRIVER

config ARCH_CHIP_P2_CUSTOM
	bool "Custom P2 chip"
	select ARCH_CHIP_CUSTOM
	select ARCH_HAVE_RNG
	select UART0_SERIALDRIVER
endchoice

config ARCH_CHIP
	string
	default "p2x8c4m64p" if ARCH_CHIP_P2X8C4M64P

config P2_SYSCLK_HZ
	int "P2 system clock frequency"
	default 180000000

config P2_XTAL_HZ
	int "P2 module TCXO frequency"
	default 20000000

config P2_UPWARD_STACK
	bool
	default y

config P2_BOOT_TRACE
	bool "Emit early P2 kernel bring-up trace markers"
	default n
	help
		Emit short, polled serial markers while the kernel establishes the
		CPU0 heap, idle context, interrupt channel, timer, and first context
		restore.  This is intended for bounded hardware bring-up and may be
		disabled once a board configuration is stable.

config P2_RNG_BLAKE2S
	bool "Condition hardware random output with BLAKE2s"
	default y
	depends on CRYPTO
	depends on DEV_RANDOM || DEV_URANDOM_ARCH
	help
		Hash batches of the P2 GETRND hardware stream before exposing them
		through /dev/random or /dev/urandom.  GETRND is seeded from on-chip
		thermal noise, but its raw Xoroshiro128** state is recoverable from
		enough output.  BLAKE2s conditioning prevents callers from observing
		the raw generator stream.

config P2_STORAGE
	bool "P2 Edge shared flash/microSD pins"
	default n
	select SPI
	help
		Enable the P2 Edge board owner for P58-P61.  Flash and microSD
		share data pins and exchange clock/chip-select roles, so they must
		use the two logical SPI lower halves supplied by this owner.

config P2_STORAGE_LOCK_TIMEOUT_TICKS
	int "Storage-owner lock timeout in ticks"
	depends on P2_STORAGE
	range 1 10000
	default 500
	help
		Maximum time a logical SPI lower half waits for the shared P58-P61
		owner.  A timeout fails closed without changing line state.

config P2_STORAGE_MAX_FREQUENCY
	int "Maximum polled storage SPI frequency"
	depends on P2_STORAGE
	range 100000 5000000
	default 1000000
	help
		Conservative ceiling for the initial C-polled lower halves.  The
		actual clock is returned to the generic SPI client.

config P2_SMARTPIN
	bool "P2 Smart Pin ownership and lower-half support"
	default n
	help
		Enable the central board pin manager and P2 Smart Pin lower-half
		drivers.  Individual standard NuttX device interfaces remain
		board-selectable.

config P2_HUB_OVERLAYS
	bool "Experimental Hub execution overlays"
	default n
	depends on P2_EC32MB_PSRAM_UNIFIED
	depends on !SMP
	help
		Reserve a fixed execution slot at the top of Hub RAM and build the
		resident dispatcher used by compiler-generated function overlays.
		Overlay images are copied from tagged PSRAM by a board-registered
		loader callback.  The dispatcher performs no filesystem or flash I/O.

		This first implementation deliberately permits one owning task and one
		root overlay call at a time.  A second task, interrupt-context entry,
		invalid metadata, loader failure, or image-integrity failure stops
		execution rather than branching into an unverified Hub image.

		Leave this disabled unless the complete overlay image has been packed,
		relocated into tagged PSRAM, and registered before its first stub call.

config P2_HUB_OVERLAY_SLOT_SIZE
	int "Hub overlay execution slot size"
	depends on P2_HUB_OVERLAYS
	range 4096 262144
	default 131072
	help
		Bytes reserved at the high end of the loader-safe Hub window for one
		overlay group.  The value must be a multiple of four.  The linker
		checks alignment and rejects an image whose resident allocation reaches
		this slot.

config P2_HUB_OVERLAY_SHADOW_DEPTH
	int "Overlay return shadow depth"
	depends on P2_HUB_OVERLAYS
	range 4 1024
	default 64
	help
		Maximum number of simultaneously active root or cross-group overlay
		calls.  Calls within the already-loaded group return directly and do
		not consume a record.  Each record holds the exact return resume plus
		caller and callee group identifiers in 12 bytes of fixed Hub memory;
		the default depth therefore costs 768 bytes and the maximum costs
		12288 bytes.  Shadow records are never placed in PSRAM.

config P2_HUB_OVERLAY_GROUP_COUNT
	int "Compiler-generated Hub overlay groups"
	depends on P2_HUB_OVERLAYS
	range 1 1024
	default 32
	help
		Number of deterministic overlay groups used for large translation-unit
		sets such as CPython.  More groups reduce the maximum bytes sharing one
		execution slot, at the cost of a larger resident descriptor table.  The
		linker discovers the actual group IDs and rejects missing IDs or a group
		whose linked body exceeds the configured slot.

config P2_HUB_OVERLAY_ZLIB
	bool "Place CPython's zlib library in the Hub overlay image"
	default n
	depends on P2_HUB_OVERLAYS
	depends on LIB_ZLIB
	depends on INTERPRETERS_CPYTHON_EXTERNAL_ROMFS
	depends on !LIB_ZLIB_TEST
	depends on !UTILS_GZIP
	depends on !UTILS_ZIP
	depends on !UTILS_UNZIP
	help
		Compile the NuttX Apps zlib implementation as compiler-generated Hub
		overlays and keep its data in external unified memory.  This is only
		safe for the serialized P2 CPython profile, where zlib bootstraps the
		compressed external standard library after the container loader is
		installed.  Standalone zlib tests and gzip/zip/unzip commands are
		excluded because another task must never enter the single-owner overlay
		slot while Python owns it.

config P2_HUB_OVERLAY_LIBM
	bool "Place the math library in the Hub overlay image"
	default n
	depends on P2_HUB_OVERLAYS
	depends on LIBM_NEWLIB
	help
		Compile libm functions as compiler-generated Hub overlays and keep
		immutable libm tables in initialized external memory.  This is intended
		for tightly constrained application profiles where every linked libm
		caller belongs to the single overlay ownership domain.  Do not enable
		it when an interrupt handler or an independently running task can call
		libm while another task owns the overlay slot.

source "arch/p2/src/p2x8c4m64p/Kconfig"
endif
```

## boards/p2/p2x8c4m64p/p2-ec/configs/showcase/defconfig
```kconfig
CONFIG_ARCH="p2"
CONFIG_ARCH_P2=y
CONFIG_ARCH_CHIP="p2x8c4m64p"
CONFIG_ARCH_CHIP_P2X8C4M64P=y
CONFIG_ARCH_BOARD="p2-ec"
CONFIG_ARCH_BOARD_P2_EC=y
CONFIG_ARCH_TOOLCHAIN_CLANG=y
# CONFIG_ARCH_LEDS is not set
CONFIG_BOARDCTL=y
CONFIG_BOARDCTL_RESET=y
CONFIG_BOARD_LATE_INITIALIZE=y
CONFIG_BCH=y
CONFIG_BUILD_FLAT=y
CONFIG_BUILTIN=y
CONFIG_DEBUG_FEATURES=y
CONFIG_DEFAULT_TASK_STACKSIZE=2048
CONFIG_DEV_CONSOLE=y
CONFIG_DISABLE_MQUEUE=y
CONFIG_DISABLE_POSIX_TIMERS=y
CONFIG_ENABLE_ALL_SIGNALS=y
CONFIG_ETC_ROMFS=y
CONFIG_FS_PROCFS=y
CONFIG_FS_ROMFS=y
CONFIG_INIT_ENTRYPOINT="nsh_main"
CONFIG_INIT_STACKSIZE=4096
CONFIG_INTELHEX_BINARY=n
CONFIG_LIBC_ARCH_ATOMIC=y
CONFIG_LIBM_NONE=y
CONFIG_LINE_MAX=128
CONFIG_NFILE_DESCRIPTORS_PER_BLOCK=8
CONFIG_NSH_ARCHINIT=n
CONFIG_NSH_BUILTIN_APPS=y
CONFIG_NSH_CMDOPT_HEXDUMP=y
# CONFIG_NSH_DISABLE_FREE is not set
# CONFIG_NSH_DISABLE_HEXDUMP is not set
# CONFIG_NSH_DISABLE_KILL is not set
# CONFIG_NSH_DISABLE_MOUNT is not set
# CONFIG_NSH_DISABLE_PS is not set
# CONFIG_NSH_DISABLE_UMOUNT is not set
CONFIG_NSH_FILEIOSIZE=512
CONFIG_NSH_READLINE=y
CONFIG_P2_BOOT_TRACE=y
CONFIG_RAM_SIZE=524288
CONFIG_RAW_BINARY=y
CONFIG_READLINE_CMD_HISTORY=y
CONFIG_READLINE_CMD_HISTORY_LEN=8
CONFIG_READLINE_CMD_HISTORY_LINELEN=64
CONFIG_READLINE_TABCOMPLETION=y
CONFIG_RR_INTERVAL=200
CONFIG_SCHED_HPWORK=n
CONFIG_SCHED_WAITPID=y
CONFIG_SERIAL_TERMIOS=y
CONFIG_SIG_DEFAULT=y
CONFIG_START_DAY=1
CONFIG_START_MONTH=1
CONFIG_START_YEAR=2026
CONFIG_SYSTEM_NSH=y
CONFIG_TTY_SIGINT=y
CONFIG_TTY_SIGINT_CHAR=0x03
CONFIG_UART0_BAUD=230400
CONFIG_UART0_SERIAL_CONSOLE=y

CONFIG_USERLED=y
CONFIG_USERLED_LOWER=y
CONFIG_EXAMPLES_LEDS=y
CONFIG_EXAMPLES_LEDS_LEDSET=0x03

CONFIG_ANALOG=y
CONFIG_SPI=y
CONFIG_SPI_EXCHANGE=y
CONFIG_SPI_BITBANG=y
CONFIG_SPI_DRIVER=y
CONFIG_P2_SMARTPIN=y
CONFIG_DEV_GPIO=y
CONFIG_DEV_GPIO_NSIGNALS=1
CONFIG_P2_EC32MB_GPIO=y
CONFIG_P2_EC32MB_GPIO_OUT_PIN=0
CONFIG_P2_EC32MB_GPIO_IN_PIN=1
CONFIG_P2_EC32MB_UART1=y
CONFIG_P2_EC32MB_UART1_TX_PIN=2
CONFIG_P2_EC32MB_UART1_RX_PIN=3
CONFIG_P2_EC32MB_UART1_BAUD=115200
CONFIG_P2_EC32MB_PWM=y
CONFIG_P2_EC32MB_PWM_PIN=4
CONFIG_PWM_NCHANNELS=1
CONFIG_P2_EC32MB_CAPTURE=y
CONFIG_P2_EC32MB_CAPTURE_PIN=5
CONFIG_P2_EC32MB_ADC=y
CONFIG_P2_EC32MB_ADC_PIN=5
CONFIG_P2_EC32MB_ADC_SAMPLE_EXPONENT=10
CONFIG_P2_EC32MB_DAC=y
CONFIG_P2_EC32MB_DAC_PIN=4
CONFIG_P2_EC32MB_SPI=y
CONFIG_P2_EC32MB_SPI_MOSI_PIN=6
CONFIG_P2_EC32MB_SPI_MISO_PIN=7
CONFIG_P2_EC32MB_SPI_SCK_PIN=8
CONFIG_P2_EC32MB_SPI_CS_PIN=9
CONFIG_P2_EC32MB_SPI_MAX_FREQUENCY=100000
CONFIG_P2_EC32MB_I2C=y
CONFIG_P2_EC32MB_I2C_SDA_PIN=24
CONFIG_P2_EC32MB_I2C_SCL_PIN=25
CONFIG_I2C_BITBANG_CLOCK_STRETCHING=y
CONFIG_I2C_BITBANG_GPIO_OVERHEAD=0
CONFIG_I2C_BITBANG_TIMEOUT=1000
CONFIG_P2_EC32MB_BMP180=y
CONFIG_SENSORS=y
CONFIG_SENSORS_BMP180=y
# CONFIG_SENSORS_BMP180_UORB is not set
CONFIG_SENSORS_USE_B16=y

CONFIG_P2_STORAGE=y
CONFIG_P2_EC32MB_STORAGE_BINDINGS=y
CONFIG_P2_EC32MB_W25_PROBE_FREQUENCY=400000
CONFIG_P2_EC32MB_FLASHBOOT=y
CONFIG_P2_STORAGE_LOCK_TIMEOUT_TICKS=500
CONFIG_P2_STORAGE_MAX_FREQUENCY=2000000
CONFIG_MTD=y
CONFIG_MTD_PARTITION=y
CONFIG_MTD_SMART=y
CONFIG_MTD_SMART_MINIMIZE_RAM=y
CONFIG_MTD_SMART_SECTOR_CACHE_SIZE=2048
CONFIG_MTD_SMART_SECTOR_PACK_COUNTS=y
CONFIG_MTD_W25=y
CONFIG_W25_SPIFREQUENCY=2000000
CONFIG_W25_SPIMODE=3
CONFIG_MMCSD=y
CONFIG_MMCSD_SPI=y
# CONFIG_MMCSD_HAVE_CARDDETECT is not set
# CONFIG_MMCSD_HAVE_WRITEPROTECT is not set
# CONFIG_MMCSD_READONLY is not set
CONFIG_MMCSD_IDMODE_CLOCK=400000
CONFIG_MMCSD_SPICLOCK=2000000
CONFIG_MMCSD_SPIMODE=0
CONFIG_FS_SMARTFS=y
CONFIG_FS_FAT=y
# CONFIG_FSUTILS_MKFATFS is not set
# CONFIG_FSUTILS_MKSMARTFS is not set

CONFIG_EXAMPLES_GPIO=y
CONFIG_EXAMPLES_PWM=y
CONFIG_EXAMPLES_PWM_FREQUENCY=1000
CONFIG_EXAMPLES_PWM_DURATION=5
CONFIG_EXAMPLES_PWM_DUTYPCT1=50
CONFIG_EXAMPLES_CAPTURE=y
CONFIG_EXAMPLES_CAPTURE_DEVPATH="/dev/cap0"
CONFIG_EXAMPLES_CAPTURE_NSAMPLES=8
CONFIG_EXAMPLES_ADC=y
CONFIG_EXAMPLES_ADC_DEVPATH="/dev/adc0"
CONFIG_EXAMPLES_ADC_NSAMPLES=8
CONFIG_EXAMPLES_ADC_GROUPSIZE=1
CONFIG_EXAMPLES_ADC_SWTRIG=y
CONFIG_EXAMPLES_DAC=y
CONFIG_EXAMPLES_DAC_DEVPATH="/dev/dac0"
CONFIG_SYSTEM_I2CTOOL=y
CONFIG_I2CTOOL_MAXBUS=0
CONFIG_I2CTOOL_DEFFREQ=100000
CONFIG_SYSTEM_SPITOOL=y
CONFIG_SPITOOL_MAXBUS=0
CONFIG_SPITOOL_DEFFREQ=100000
CONFIG_SPITOOL_DEFMODE=0
CONFIG_SPITOOL_DEFWORDS=16
# CONFIG_SYSTEM_DD is not set
CONFIG_SYSTEM_P2HELP=y

CONFIG_TESTING_P2SMARTPINS=y
CONFIG_TESTING_P2SMARTPINS_EDGE=y
CONFIG_TESTING_P2SMARTPINS_UART=y
CONFIG_TESTING_P2SMARTPINS_PWM_CAPTURE=y
CONFIG_TESTING_P2SMARTPINS_DAC_ADC=y
CONFIG_TESTING_P2SMARTPINS_DAC_FULL_SCALE=65535
CONFIG_TESTING_P2SMARTPINS_SPI=y
CONFIG_TESTING_P2I2C=y
CONFIG_TESTING_P2STORAGE=y
# CONFIG_TESTING_P2STORAGE_DESTRUCTIVE is not set
CONFIG_TESTING_P2STORAGE_FLASH_PREMOUNTED=y
CONFIG_TESTING_P2STORAGE_FLASH_DEVPATH="/dev/smart0"
CONFIG_TESTING_P2STORAGE_FLASH_MOUNTPOINT="/mnt/flash"
CONFIG_TESTING_P2STORAGE_SD_DEVPATH="/dev/mmcsd0"
CONFIG_TESTING_P2STORAGE_SD_MOUNTPOINT="/mnt/sd"
CONFIG_TESTING_P2STORAGE_RECORD_SIZE=256
CONFIG_TESTING_P2STORAGE_STREAM_SIZE=1048576
```
