## boards/p2/p2x8c4m64p/p2-ec32mb/configs/schedstress/defconfig
```kconfig
CONFIG_ARCH="p2"
CONFIG_ARCH_P2=y
CONFIG_ARCH_CHIP="p2x8c4m64p"
CONFIG_ARCH_CHIP_P2X8C4M64P=y
CONFIG_ARCH_BOARD="p2-ec32mb"
CONFIG_ARCH_BOARD_P2_EC32MB=y
CONFIG_ARCH_TOOLCHAIN_CLANG=y
CONFIG_BUILD_FLAT=y
CONFIG_CANCELLATION_POINTS=y
CONFIG_DEFAULT_TASK_STACKSIZE=3072
CONFIG_DEV_CONSOLE=y
CONFIG_DISABLE_ENVIRON=y
CONFIG_DISABLE_MOUNTPOINT=y
CONFIG_DISABLE_MQUEUE_SYSV=y
CONFIG_ENABLE_ALL_SIGNALS=y
CONFIG_INIT_ENTRYPOINT="p2schedstress_main"
CONFIG_INIT_PRIORITY=100
CONFIG_INIT_STACKSIZE=6144
CONFIG_INTELHEX_BINARY=n
CONFIG_LIBC_ARCH_ATOMIC=y
CONFIG_LIBM_NONE=y
CONFIG_P2_BOOT_TRACE=y
CONFIG_PREALLOC_CHILDSTATUS=8
CONFIG_PREALLOC_MQ_MSGS=4
CONFIG_PREALLOC_TIMERS=2
CONFIG_PRIORITY_INHERITANCE=y
CONFIG_PTHREAD_MUTEX_BOTH=y
CONFIG_PTHREAD_MUTEX_TYPES=y
CONFIG_PTHREAD_STACK_DEFAULT=3072
CONFIG_RAM_SIZE=524288
CONFIG_RAW_BINARY=y
CONFIG_RR_INTERVAL=10
CONFIG_SCHED_CHILD_STATUS=y
CONFIG_SCHED_HAVE_PARENT=y
CONFIG_SCHED_WAITPID=y
CONFIG_SEM_PREALLOCHOLDERS=8
CONFIG_STACK_COLORATION=y
CONFIG_STACK_USAGE=y
CONFIG_START_DAY=1
CONFIG_START_MONTH=1
CONFIG_START_YEAR=2026
CONFIG_TESTING_P2SCHEDSTRESS=y
CONFIG_TESTING_P2SCHEDSTRESS_PRIORITY=120
CONFIG_TESTING_P2SCHEDSTRESS_STACKSIZE=3072
CONFIG_TESTING_P2SCHEDSTRESS_TASK_STACKSIZE=2048
CONFIG_UART0_BAUD=230400
CONFIG_UART0_SERIAL_CONSOLE=y
```

## boards/p2/p2x8c4m64p/p2-ec32mb/configs/sdio-record/defconfig
```kconfig
CONFIG_ARCH="p2"
CONFIG_ARCH_P2=y
CONFIG_ARCH_CHIP="p2x8c4m64p"
CONFIG_ARCH_CHIP_P2X8C4M64P=y
CONFIG_ARCH_BOARD="p2-ec32mb"
CONFIG_ARCH_BOARD_P2_EC32MB=y
CONFIG_ARCH_TOOLCHAIN_CLANG=y
CONFIG_BOARDCTL=y
CONFIG_BOARD_LATE_INITIALIZE=y
CONFIG_BCH=y
CONFIG_BUILD_FLAT=y
CONFIG_BUILTIN=y
CONFIG_DEBUG_FEATURES=y
CONFIG_DEV_CONSOLE=y
CONFIG_DISABLE_MQUEUE=y
CONFIG_DISABLE_POSIX_TIMERS=y
CONFIG_INIT_ENTRYPOINT="nsh_main"
CONFIG_INTELHEX_BINARY=n
CONFIG_LIBC_ARCH_ATOMIC=y
CONFIG_LIBM_NONE=y
CONFIG_NFILE_DESCRIPTORS=12
CONFIG_NSH_ARCHINIT=n
CONFIG_NSH_BUILTIN_APPS=y
CONFIG_NSH_FILEIOSIZE=65536
CONFIG_NSH_READLINE=y
CONFIG_PREALLOC_TIMERS=2
CONFIG_RAM_SIZE=524288
CONFIG_RAW_BINARY=y
CONFIG_P2_BOOT_TRACE=y
CONFIG_RR_INTERVAL=200
CONFIG_SCHED_HPWORK=n
CONFIG_START_DAY=1
CONFIG_START_MONTH=1
CONFIG_START_YEAR=2026
CONFIG_SYSTEM_NSH=y
CONFIG_UART0_BAUD=230400
CONFIG_UART0_SERIAL_CONSOLE=y

# The 360-MHz core clock and 120-MHz SD clock are out-of-spec HIL record
# settings.  The driver does not activate 120 MHz unless SD CMD6 High Speed
# negotiation succeeds and a repeated CRC16-valid RX phase calibration passes.

CONFIG_P2_EXPERIMENTAL_OVERCLOCK=y
CONFIG_P2_SYSCLK_HZ=360000000
CONFIG_P2_SMARTPIN=y
CONFIG_P2_EC32MB_SDIO_NATIVE=y
CONFIG_P2_EC32MB_SDIO_COMMAND_HZ=5000000
CONFIG_P2_EC32MB_SDIO_DIVISOR=3
CONFIG_P2_EC32MB_SDIO_ALLOW_OVERCLOCK=y
# CONFIG_P2_EC32MB_SDIO_VERIFY_FAST_CRC16 is not set
CONFIG_P2_EC32MB_SDIO_RESPONSE_CLOCKS=64
CONFIG_P2_EC32MB_SDIO_START_CLOCKS=1000000
CONFIG_P2_EC32MB_SDIO_BUSY_TIMEOUT_MS=1000
CONFIG_P2_EC32MB_SDIO_SERVICE_TIMEOUT_MS=1000
CONFIG_P2_EC32MB_SDIO_MAX_TRANSFER=262144

# Keep the onboard W25/SMART binding needed by the p2storage benchmark app.
# MMCSD_SPI remains disabled: native SDIO exclusively owns /dev/mmcsd0 and
# the W25 pins P58-P61 are independent of the external P16-P23 fixture.

CONFIG_P2_STORAGE=y
CONFIG_P2_EC32MB_STORAGE_BINDINGS=y
CONFIG_P2_EC32MB_W25_PROBE_FREQUENCY=400000
CONFIG_P2_STORAGE_LOCK_TIMEOUT_TICKS=500
CONFIG_P2_STORAGE_MAX_FREQUENCY=2000000
CONFIG_MTD=y
CONFIG_MTD_PARTITION=y
CONFIG_MTD_SMART=y
CONFIG_MTD_W25=y
CONFIG_W25_SPIFREQUENCY=2000000
CONFIG_W25_SPIMODE=3

CONFIG_MMCSD=y
CONFIG_MMCSD_SDIO=y
CONFIG_MMCSD_READONLY=y
CONFIG_MMCSD_MULTIBLOCK_LIMIT=512
CONFIG_SDIO_BLOCKSETUP=y
# CONFIG_MMCSD_SPI is not set
# CONFIG_MMCSD_MMCSUPPORT is not set
# CONFIG_MMCSD_HAVE_CARDDETECT is not set
# CONFIG_MMCSD_HAVE_WRITEPROTECT is not set
CONFIG_FS_FAT=y
CONFIG_FS_SMARTFS=y
CONFIG_TESTING_P2STORAGE=y
CONFIG_TESTING_P2STORAGE_SD_BENCHMARK=y
CONFIG_TESTING_P2STORAGE_BENCHMARK_BUFFER_SIZE=65536
# CONFIG_TESTING_P2STORAGE_DESTRUCTIVE is not set
CONFIG_TESTING_P2STORAGE_FLASH_DEVPATH="/dev/smart0"
CONFIG_TESTING_P2STORAGE_FLASH_MOUNTPOINT="/mnt/flash"
CONFIG_TESTING_P2STORAGE_SD_DEVPATH="/dev/mmcsd0"
CONFIG_TESTING_P2STORAGE_SD_MOUNTPOINT="/mnt/sd"
CONFIG_TESTING_P2STORAGE_RECORD_SIZE=256
CONFIG_TESTING_P2STORAGE_STREAM_SIZE=1048576
# CONFIG_SYSTEM_DD is not set
```

## boards/p2/p2x8c4m64p/p2-ec32mb/configs/smartpins/defconfig
```kconfig
CONFIG_ARCH="p2"
CONFIG_ARCH_P2=y
CONFIG_ARCH_CHIP="p2x8c4m64p"
CONFIG_ARCH_CHIP_P2X8C4M64P=y
CONFIG_ARCH_BOARD="p2-ec32mb"
CONFIG_ARCH_BOARD_P2_EC32MB=y
CONFIG_ARCH_TOOLCHAIN_CLANG=y
CONFIG_BOARDCTL=y
CONFIG_BOARD_LATE_INITIALIZE=y
CONFIG_BUILD_FLAT=y
CONFIG_DEBUG_FEATURES=y
CONFIG_DEV_CONSOLE=y
CONFIG_DISABLE_MQUEUE=y
CONFIG_DISABLE_POSIX_TIMERS=y
CONFIG_INIT_ENTRYPOINT="p2smartpins_main"
CONFIG_INTELHEX_BINARY=n
CONFIG_LIBC_ARCH_ATOMIC=y
CONFIG_LIBM_NONE=y
CONFIG_NFILE_DESCRIPTORS=8
CONFIG_NSH_ARCHINIT=n
CONFIG_NSH_BUILTIN_APPS=y
CONFIG_NSH_FILEIOSIZE=512
CONFIG_NSH_READLINE=y
CONFIG_PREALLOC_TIMERS=2
CONFIG_RAM_SIZE=524288
CONFIG_RAW_BINARY=y
CONFIG_P2_BOOT_TRACE=y
CONFIG_RR_INTERVAL=200
CONFIG_SCHED_HPWORK=n
CONFIG_START_DAY=1
CONFIG_START_MONTH=1
CONFIG_START_YEAR=2026
CONFIG_SYSTEM_NSH=y
CONFIG_UART0_BAUD=230400
CONFIG_UART0_SERIAL_CONSOLE=y
CONFIG_P2_SMARTPIN=y
CONFIG_DEV_GPIO=y
CONFIG_DEV_GPIO_NSIGNALS=1
CONFIG_P2_EC32MB_GPIO=y
CONFIG_P2_EC32MB_GPIO_OUT_PIN=0
CONFIG_P2_EC32MB_GPIO_IN_PIN=1
CONFIG_P2_EC32MB_UART1=y
CONFIG_P2_EC32MB_UART1_TX_PIN=2
CONFIG_P2_EC32MB_UART1_RX_PIN=3
CONFIG_P2_EC32MB_UART1_BAUD=115200
CONFIG_SERIAL_TERMIOS=y
CONFIG_P2_EC32MB_PWM=y
CONFIG_P2_EC32MB_PWM_PIN=4
CONFIG_PWM_NCHANNELS=1
CONFIG_P2_EC32MB_CAPTURE=y
CONFIG_P2_EC32MB_CAPTURE_PIN=5
CONFIG_P2_EC32MB_ADC=y
CONFIG_P2_EC32MB_ADC_PIN=5
CONFIG_P2_EC32MB_ADC_SAMPLE_EXPONENT=10
CONFIG_P2_EC32MB_DAC=y
CONFIG_P2_EC32MB_DAC_PIN=4
CONFIG_TESTING_P2SMARTPINS=y
CONFIG_TESTING_P2SMARTPINS_EDGE=y
CONFIG_TESTING_P2SMARTPINS_UART=y
CONFIG_TESTING_P2SMARTPINS_PWM_CAPTURE=y
# CONFIG_TESTING_P2SMARTPINS_DAC_ADC is not set
# CONFIG_TESTING_P2SMARTPINS_SPI is not set
```

## boards/p2/p2x8c4m64p/p2-ec32mb/configs/touchcal/defconfig
```kconfig
CONFIG_ARCH="p2"
CONFIG_ARCH_P2=y
CONFIG_ARCH_CHIP="p2x8c4m64p"
CONFIG_ARCH_CHIP_P2X8C4M64P=y
CONFIG_ARCH_BOARD="p2-ec32mb"
CONFIG_ARCH_BOARD_P2_EC32MB=y
CONFIG_ARCH_TOOLCHAIN_CLANG=y
# CONFIG_ARCH_LEDS is not set
CONFIG_BOARDCTL=y
CONFIG_BOARD_LATE_INITIALIZE=y
CONFIG_BUILD_FLAT=y
CONFIG_BUILTIN=y
CONFIG_DEBUG_FEATURES=y
CONFIG_DEFAULT_TASK_STACKSIZE=2048
CONFIG_DEV_CONSOLE=y
CONFIG_DISABLE_MQUEUE=y
CONFIG_DISABLE_POSIX_TIMERS=y
CONFIG_ENABLE_ALL_SIGNALS=y
CONFIG_ETC_ROMFS=y
CONFIG_FS_ROMFS=y
CONFIG_INIT_ENTRYPOINT="nsh_main"
CONFIG_INIT_STACKSIZE=4096
CONFIG_INTELHEX_BINARY=n
CONFIG_LIBC_ARCH_ATOMIC=y
CONFIG_LIBM_NONE=y
CONFIG_NFILE_DESCRIPTORS=10
CONFIG_NFILE_DESCRIPTORS_PER_BLOCK=8
CONFIG_NSH_ARCHINIT=n
CONFIG_NSH_BUILTIN_APPS=y
# CONFIG_NSH_DISABLE_FREE is not set
# CONFIG_NSH_DISABLE_PS is not set
CONFIG_NSH_FILEIOSIZE=512
CONFIG_NSH_READLINE=y
CONFIG_P2_BOOT_TRACE=y
CONFIG_PREALLOC_TIMERS=4
CONFIG_RAM_SIZE=524288
CONFIG_RAW_BINARY=y
CONFIG_RR_INTERVAL=200
CONFIG_SCHED_HPWORK=y
CONFIG_SCHED_HPWORKPRIORITY=224
CONFIG_SCHED_HPWORKSTACKSIZE=2048
CONFIG_SCHED_WAITPID=y
CONFIG_START_DAY=1
CONFIG_START_MONTH=1
CONFIG_START_YEAR=2026
CONFIG_SYSTEM_NSH=y
# CONFIG_SYSTEM_DD is not set
CONFIG_UART0_BAUD=230400
CONFIG_UART0_SERIAL_CONSOLE=y

CONFIG_P2_SMARTPIN=y
CONFIG_SPI=y
CONFIG_SPI_BITBANG=y
CONFIG_SPI_BITBANG_VARWIDTH=y
CONFIG_SPI_CMDDATA=y
CONFIG_SPI_DRIVER=y
CONFIG_SPI_EXCHANGE=y
CONFIG_P2_EC32MB_SPI=y
CONFIG_P2_EC32MB_SPI_MOSI_PIN=6
CONFIG_P2_EC32MB_SPI_MISO_PIN=7
CONFIG_P2_EC32MB_SPI_SCK_PIN=8
CONFIG_P2_EC32MB_SPI_CS_PIN=11
CONFIG_P2_EC32MB_SPI_MAX_FREQUENCY=2000000

CONFIG_LCD=y
CONFIG_LCD_DEV=y
CONFIG_LCD_FRAMEBUFFER=y
CONFIG_LCD_ILI9341=y
CONFIG_LCD_ILI9341_BGR=y
CONFIG_LCD_ILI9341_IFACE0=y
CONFIG_LCD_ILI9341_IFACE0_WIDTH=240
CONFIG_LCD_ILI9341_IFACE0_HEIGHT=320
CONFIG_LCD_ILI9341_IFACE0_PORTRAIT=y
CONFIG_LCD_ILI9341_IFACE0_RGB565=y
CONFIG_LCD_ILI9341_NINTERFACES=1
CONFIG_LCD_MAXPOWER=1
CONFIG_DRIVERS_VIDEO=y
CONFIG_VIDEO_FB=y

CONFIG_INPUT=y
CONFIG_INPUT_ADS7843E=y
CONFIG_ADS7843E_DEVMINOR=0
CONFIG_ADS7843E_FREQUENCY=500000
CONFIG_ADS7843E_SPIDEV=0
CONFIG_ADS7843E_SPIMODE=0
CONFIG_ADS7843E_THRESHX=0
CONFIG_ADS7843E_THRESHY=0

CONFIG_P2_EC32MB_ILI9341_XPT2046=y
CONFIG_P2_EC32MB_ILI9341_RESET_PIN=9
CONFIG_P2_EC32MB_ILI9341_DC_PIN=10
CONFIG_P2_EC32MB_ILI9341_FREQUENCY=2000000
CONFIG_P2_EC32MB_XPT2046_CS_PIN=12
CONFIG_P2_EC32MB_XPT2046_PEN_PIN=14
CONFIG_P2_EC32MB_TOUCHPEN_GPIO_ONLY=y
CONFIG_P2_EC32MB_TOUCHPEN_FLOAT_INPUT=y

CONFIG_EXAMPLES_P2TOUCHCAL=y
CONFIG_EXAMPLES_P2TOUCHCAL_PRIORITY=100
CONFIG_EXAMPLES_P2TOUCHCAL_STACKSIZE=4096
CONFIG_EXAMPLES_P2TOUCHCAL_FB_DEVPATH="/dev/fb0"
CONFIG_EXAMPLES_P2TOUCHCAL_INPUT_DEVPATH="/dev/input0"
CONFIG_P2_EC32MB_TOUCHPEN_AUTOSTART=y
```

## boards/p2/p2x8c4m64p/p2-ec32mb/configs/unified-hil/defconfig
```kconfig
CONFIG_ARCH="p2"
CONFIG_ARCH_P2=y
CONFIG_ARCH_CHIP="p2x8c4m64p"
CONFIG_ARCH_CHIP_P2X8C4M64P=y
CONFIG_ARCH_BOARD="p2-ec32mb"
CONFIG_ARCH_BOARD_P2_EC32MB=y
CONFIG_ARCH_TOOLCHAIN_CLANG=y
CONFIG_BOARDCTL=y
CONFIG_BOARD_LATE_INITIALIZE=y
CONFIG_BUILD_FLAT=y
CONFIG_BUILTIN=y
CONFIG_DEBUG_FEATURES=y
CONFIG_DEV_CONSOLE=y
CONFIG_DISABLE_MQUEUE=y
CONFIG_DISABLE_POSIX_TIMERS=y
CONFIG_FS_PROCFS=y
CONFIG_INIT_ENTRYPOINT="nsh_main"
CONFIG_INTELHEX_BINARY=n
CONFIG_LIBC_ARCH_ATOMIC=y
CONFIG_LIBM_NONE=y
CONFIG_MM_KERNEL_HEAP=y
CONFIG_MM_KERNEL_HEAPSIZE=131072
CONFIG_MM_REGIONS=2
CONFIG_NFILE_DESCRIPTORS=8
CONFIG_NSH_ARCHINIT=n
CONFIG_NSH_BUILTIN_APPS=y
CONFIG_NSH_FILEIOSIZE=512
CONFIG_NSH_READLINE=y
# CONFIG_NSH_DISABLE_FREE is not set
# CONFIG_NSH_DISABLE_PS is not set
CONFIG_P2_BOOT_TRACE=y
CONFIG_P2_EC32MB_PSRAM_UNIFIED=y
CONFIG_P2_EC32MB_PSRAM_UNIFIED_SELFTEST=y
CONFIG_P2_EC32MB_PSRAM_UNIFIED_SELFTEST_FULL=y
CONFIG_P2_SMARTPIN=y
CONFIG_PREALLOC_TIMERS=2
CONFIG_RAM_SIZE=524288
CONFIG_RAW_BINARY=y
CONFIG_RR_INTERVAL=200
CONFIG_SCHED_HPWORK=n
CONFIG_START_DAY=1
CONFIG_START_MONTH=1
CONFIG_START_YEAR=2026
# CONFIG_SYSTEM_DD is not set
CONFIG_SYSTEM_NSH=y
CONFIG_UART0_BAUD=230400
CONFIG_UART0_SERIAL_CONSOLE=y
CONFIG_USEC_PER_TICK=10000
```
