## boards/p2/p2x8c4m64p/p2-ec32mb/Kconfig
```kconfig
if ARCH_BOARD_P2_EC32MB || ARCH_BOARD_P2_EC

config BOARD_LOOPSPERMSEC
	int
	default 18000

config P2_EDGE_BASE_IMAGE
	bool "Identify the Berry/CLE/vi base image"
	default n
	help
		Emit the P2BASE boot marker used to qualify the common flat base image
		for P2-EC32MB Rev B and P2-EC Rev D.

config P2_EC32MB_STORAGE_BINDINGS
	bool "Bind the onboard flash and microSD drivers during late init"
	default y
	depends on P2_STORAGE && BOARD_LATE_INITIALIZE
	help
		Bind each configured standard storage driver after the scheduler is
		available.  When MTD partition, SMART, and SmartFS support are
		enabled, the raw W25 MTD remains private while a SMART block driver
		is bound only to the board's data partition.  The MMC/SD SPI driver
		registers /dev/mmcsd0 even when no card responds.  This option does
		not automatically format or mount either medium.

config P2_EC32MB_SDCARD_AUTOMOUNT
	bool "Mount the existing microSD FAT filesystem at /mnt/sd"
	default n
	depends on P2_EC32MB_STORAGE_BINDINGS && MMCSD_SPI && FS_FAT
	depends on ETC_ROMFS && SYSTEM_NSH
	help
		Mount /dev/mmcsd0 as vfat at /mnt/sd from the board rcS script.
		The card must be inserted at boot because this socket has no
		card-detect GPIO.  Mount failure is reported and never triggers
		automatic formatting.

config P2_EC32MB_W25_PROBE_FREQUENCY
	int "W25 wake and JEDEC probe frequency"
	default 400000
	range 100000 400000
	depends on P2_EC32MB_STORAGE_BINDINGS && MTD_W25
	help
		Use this conservative frequency only while waking the onboard W25
		flash and reading its JEDEC identity.  The board restores
		CONFIG_W25_SPIFREQUENCY before handing the SPI lower half to the
		generic W25 driver.

config P2_EC32MB_FLASHBOOT
	bool "Enable the reset-only flash-boot persistence profile"
	default n
	depends on P2_EC32MB_STORAGE_BINDINGS && ETC_ROMFS
	help
		Build the board ROMFS startup contract that mounts the existing
		/dev/smart0 filesystem without formatting it.  This profile is
		intentionally incompatible with destructive p2storage handlers and
		filesystem-formatting utilities.

config P2_EC32MB_PSRAM_SERVICE
	bool
	default n

config P2_EC32MB_PSRAM
	bool "Register the onboard 32-MiB PSRAM service"
	default n
	depends on ARCH_BOARD_P2_EC32MB
	depends on P2_SMARTPIN && BOARD_LATE_INITIALIZE
	select P2_EC32MB_PSRAM_SERVICE
	help
		Start one non-scheduler cog as a bounded QPI transfer engine and
		register the four interleaved APS6404L chips as /dev/psram0.  This is
		an explicit character-device bulk store, not native address space;
		applications must use read, write, seek, or the board transfer API.

config P2_EC32MB_PSRAM_UNIFIED
	bool "Use onboard PSRAM as unified user memory"
	default n
	depends on ARCH_BOARD_P2_EC32MB
	depends on P2_SMARTPIN
	depends on BUILD_FLAT
	depends on !SMP
	depends on !P2_EC32MB_PSRAM
	select ARCH_HAVE_EXTRA_HEAPS
	select MM_KERNEL_HEAP
	select P2_EC32MB_PSRAM_SERVICE
	help
		Expose the four interleaved APS6404L chips as a tagged 32-MiB
		user-heap region at 0x10000000.  A p2llvm memory-lowering pass routes
		loads, stores, and bulk memory operations for that tagged range through
		the board's dedicated QPI service cog.  Code, interrupt state, and every
		task stack remain in Hub RAM.  Explicitly linked external-data sections
		may also occupy a reserved prefix which is excluded from the heap.  This
		mode does not register /dev/psram0 and is supported only by the flat
		uniprocessor P2 port.

config P2_EC32MB_PSRAM_UNIFIED_RESERVE_SIZE
	int "Bytes reserved before the unified PSRAM heap"
	default 0
	range 0 16777216
	depends on P2_EC32MB_PSRAM_UNIFIED
	help
		Exclude this aligned prefix at 0x10000000 from the NuttX heap.  A board
		runtime may use it for validated external globals, overlay backing, and
		read-only filesystem images.  Zero preserves the full 32-MiB heap used
		by existing profiles.  The value must be a multiple of 16 bytes.

config P2_EC32MB_PYTHON_CONTAINER_OFFSET
	int
	default 2097152
	depends on INTERPRETERS_CPYTHON_EXTERNAL_ROMFS
	help
		Keep the validated P2 Python container at the fixed tagged address
		0x10200000, two MiB after the start of PSRAM.  The preceding region is
		reserved for compiler-externalized initialized and zero-filled data.
		This hidden value is part of the resident-image/container ABI and must
		stay synchronized with the linker and host packager checks.

config P2_EC32MB_PSRAM_UNIFIED_SELFTEST
	bool "Run the unified PSRAM boot self-test"
	default n
	depends on P2_EC32MB_PSRAM_UNIFIED && BOARD_LATE_INITIALIZE
	help
		Run scalar, bulk-memory, allocator, fragmentation, realloc, free,
		and concurrent-task checks against tagged PSRAM during board late
		initialization.  Deterministic P2XMEM markers report the result.  This
		is an opt-in HIL diagnostic and is not enabled by the normal unified
		profile.

config P2_EC32MB_PSRAM_UNIFIED_SELFTEST_FULL
	bool "Destructively test every PSRAM byte before heap registration"
	default n
	depends on P2_EC32MB_PSRAM_UNIFIED_SELFTEST
	help
		Before adding PSRAM to the user heap, write an address-dependent
		pattern across the complete 32-MiB device, read back every byte, and
		compute a deterministic FNV-1a checksum.  This erases all PSRAM and
		considerably extends boot time; enable it only for an explicitly armed
		HIL run.

config P2_EC32MB_PSRAM_UNIFIED_FAULT_INJECT_RAW_LOCK
	bool "Park the PSRAM worker while it owns the service lock"
	default n
	depends on P2_EC32MB_PSRAM_UNIFIED_SELFTEST
	select BOARDCTL
	select BOARDCTL_RESET
	help
		After the normal unified-memory self-test passes, arm one request that
		parks the service cog while it owns the descriptor hardware lock.  The
		caller must still reach its hardware-counter deadline, stop the service
		cog, reclaim the orphaned lock, and report bounded terminal failure.
		The test then resets intentionally; enable it only for a dedicated HIL
		fault-injection image whose reboot is expected.

config P2_EC32MB_PSRAM_COG_STACKSIZE
	int "PSRAM service-cog stack size"
	default 3072
	range 2048 8192
	depends on P2_EC32MB_PSRAM_SERVICE
	help
		Reserve this many long-aligned Hub RAM bytes for the dedicated
		service cog.  Guard words are checked around the stack.

config P2_EC32MB_PSRAM_MAX_REQUEST
	int "Maximum PSRAM service request size"
	default 65536
	range 4096 65536
	depends on P2_EC32MB_PSRAM_SERVICE
	help
		Split larger character-device transfers into requests no larger than
		this many bytes so cancellation and recovery remain bounded.

config P2_EC32MB_PSRAM_TIMEOUT_TICKS
	int "Default PSRAM request timeout in ticks"
	default 500
	range 1 2147483647
	depends on P2_EC32MB_PSRAM_SERVICE

config P2_EC32MB_PSRAM_CANCEL_GRACE_TICKS
	int "PSRAM cancellation grace period in ticks"
	default 100
	range 1 2147483647
	depends on P2_EC32MB_PSRAM_SERVICE
	help
		Wait this long for cooperative cancellation before stopping the
		service cog, floating P40-P57, and permanently failing the device.

config P2_EC32MB_GPIO
	bool "Register the P2 Smart Pin GPIO loopback pair"
	default n
	depends on P2_SMARTPIN && DEV_GPIO
	select SYSTEMTICK_HOOK
	help
		Register one configurable output and one configurable input through
		the standard NuttX GPIO upper half.  The device minor is the physical
		P2 pin number.  The default P0/P1 pair matches the documented HIL
		fixture.

config P2_EC32MB_GPIO_OUT_PIN
	int "GPIO loopback output pin"
	default 0
	range 0 39 if ARCH_BOARD_P2_EC32MB
	range 0 55 if ARCH_BOARD_P2_EC
	depends on P2_EC32MB_GPIO

config P2_EC32MB_GPIO_IN_PIN
	int "GPIO loopback input pin"
	default 1
	range 0 39 if ARCH_BOARD_P2_EC32MB
	range 0 55 if ARCH_BOARD_P2_EC
	depends on P2_EC32MB_GPIO

config P2_EC32MB_UART1
	bool "Register a configurable non-console Smart Pin UART"
	default n
	depends on P2_SMARTPIN && SERIAL
	select SYSTEMTICK_HOOK
	help
		Register a polled Smart Pin UART as /dev/ttyS1.  The receiver is
		serviced from the system-tick hook and after each transmitted byte.
		The default P2/P3 allocation matches the documented loopback fixture.

config P2_EC32MB_UART1_TX_PIN
	int "Non-console UART TX pin"
	default 2
	range 0 39 if ARCH_BOARD_P2_EC32MB
	range 0 55 if ARCH_BOARD_P2_EC
	depends on P2_EC32MB_UART1

config P2_EC32MB_UART1_RX_PIN
	int "Non-console UART RX pin"
	default 3
	range 0 39 if ARCH_BOARD_P2_EC32MB
	range 0 55 if ARCH_BOARD_P2_EC
	depends on P2_EC32MB_UART1

config P2_EC32MB_UART1_BAUD
	int "Non-console UART baud"
	default 115200
	range 1200 1000000
	depends on P2_EC32MB_UART1

config P2_EC32MB_UART1_RXBUFSIZE
	int "Non-console UART RX buffer size"
	default 64
	range 16 512
	depends on P2_EC32MB_UART1

config P2_EC32MB_UART1_TXBUFSIZE
	int "Non-console UART TX buffer size"
	default 64
	range 16 512
	depends on P2_EC32MB_UART1

config P2_EC32MB_PWM
	bool "Register a Smart Pin PWM output"
	default n
	depends on P2_SMARTPIN
	select PWM
	help
		Register a standard NuttX PWM lower half as /dev/pwm0.  The default
		P4 output uses the documented P4/P5 PWM/capture loopback pair.

config P2_EC32MB_PWM_PIN
	int "PWM output pin"
	default 4
	range 0 39 if ARCH_BOARD_P2_EC32MB
	range 0 55 if ARCH_BOARD_P2_EC
	depends on P2_EC32MB_PWM

config P2_EC32MB_CAPTURE
	bool "Register a Smart Pin capture/counter input"
	default n
	depends on P2_SMARTPIN
	select CAPTURE
	help
		Register /dev/cap0 using autonomous Smart Pin period, high-time,
		and rising-edge counter modes.  All synchronous measurements have a
		bounded one-second timeout.

config P2_EC32MB_CAPTURE_PIN
	int "Capture input pin"
	default 5
	range 0 39 if ARCH_BOARD_P2_EC32MB
	range 0 55 if ARCH_BOARD_P2_EC
	depends on P2_EC32MB_CAPTURE

config P2_EC32MB_ADC
	bool "Register a Smart Pin ADC input"
	default n
	depends on P2_SMARTPIN && ANALOG
	select ADC
	help
		Register the P2 internal SINC2 Smart Pin ADC as /dev/adc0.  Samples
		are raw, uncalibrated ADC accumulator values.  The default P5 input
		shares the documented P4/P5 fixture with the capture lower half;
		the pin manager permits only one open owner at a time.

config P2_EC32MB_ADC_PIN
	int "ADC input pin"
	default 5
	range 0 39 if ARCH_BOARD_P2_EC32MB
	range 0 55 if ARCH_BOARD_P2_EC
	depends on P2_EC32MB_ADC

config P2_EC32MB_ADC_SAMPLE_EXPONENT
	int "ADC SINC2 sample-period exponent"
	default 10
	range 4 15
	depends on P2_EC32MB_ADC
	help
		The ADC sample period is 2^N system clocks and SINC2 sampling
		produces N+1 raw bits.

config P2_EC32MB_DAC
	bool "Register a Smart Pin 16-bit dithered DAC output"
	default n
	depends on P2_SMARTPIN && ANALOG
	select DAC
	help
		Register /dev/dac0 using the P2 990-ohm, 3.3-V DAC with 16-bit PWM
		dithering.  The default P4 output shares the P4/P5 fixture with PWM;
		the pin manager permits only one open owner at a time.

config P2_EC32MB_DAC_PIN
	int "DAC output pin"
	default 4
	range 0 39 if ARCH_BOARD_P2_EC32MB
	range 0 55 if ARCH_BOARD_P2_EC
	depends on P2_EC32MB_DAC

config P2_EC32MB_SPI
	bool "Register the P6/P7 general-purpose SPI loopback controller"
	default n
	depends on P2_SMARTPIN && SPI_BITBANG && SPI_DRIVER && SPI_EXCHANGE
	help
		Register a generic bit-banged SPI controller as /dev/spi0.  The
		default HIL wiring drives P6 MOSI into P7 MISO while P8 SCK and P9
		chip select remain deliberately unconnected.  The receiver is
		configured before the source and every pin floats after deselect.

config P2_EC32MB_SPI_MOSI_PIN
	int "General-purpose SPI MOSI pin"
	default 6
	range 0 37 if ARCH_BOARD_P2_EC32MB
	range 0 55 if ARCH_BOARD_P2_EC
	depends on P2_EC32MB_SPI

config P2_EC32MB_SPI_MISO_PIN
	int "General-purpose SPI MISO pin"
	default 7
	range 0 37 if ARCH_BOARD_P2_EC32MB
	range 0 55 if ARCH_BOARD_P2_EC
	depends on P2_EC32MB_SPI

config P2_EC32MB_SPI_SCK_PIN
	int "General-purpose SPI clock pin"
	default 8
	range 0 37 if ARCH_BOARD_P2_EC32MB
	range 0 55 if ARCH_BOARD_P2_EC
	depends on P2_EC32MB_SPI

config P2_EC32MB_SPI_CS_PIN
	int "General-purpose SPI chip-select pin"
	default 9
	range 0 37 if ARCH_BOARD_P2_EC32MB
	range 0 55 if ARCH_BOARD_P2_EC
	depends on P2_EC32MB_SPI

config P2_EC32MB_SPI_MAX_FREQUENCY
	int "General-purpose SPI maximum frequency"
	default 100000
	range 1000 100000
	depends on P2_EC32MB_SPI

config P2_EC32MB_I2C
	bool "Register the P24/P25 open-drain I2C controller"
	default n
	depends on P2_SMARTPIN
	select I2C
	select I2C_BITBANG
	select I2C_DRIVER
	help
		Register the normal NuttX I2C bit-bang lower half as /dev/i2c0.
		Both lines use true open-drain release and must be held high by
		external pull-ups.  The default P24 SDA and P25 SCL allocation matches
		the documented BMP180 hardware-in-the-loop fixture.

config P2_EC32MB_I2C_SDA_PIN
	int "I2C SDA pin"
	default 24
	range 0 37 if ARCH_BOARD_P2_EC32MB
	range 0 55 if ARCH_BOARD_P2_EC
	depends on P2_EC32MB_I2C

config P2_EC32MB_I2C_SCL_PIN
	int "I2C SCL pin"
	default 25
	range 0 37 if ARCH_BOARD_P2_EC32MB
	range 0 55 if ARCH_BOARD_P2_EC
	depends on P2_EC32MB_I2C

config P2_EC32MB_BMP180
	bool "Bind the BMP180 pressure sensor on I2C0"
	default n
	depends on P2_EC32MB_I2C
	select SENSORS_BMP180
	help
		Probe the BMP180 at its fixed 7-bit address 0x77 and register the
		legacy pressure character interface as /dev/press0.  A successful
		probe requires the documented chip ID 0x55.
endif
```
