## boards/p2/p2x8c4m64p/p2-ec32mb/configs/base/defconfig
```kconfig
CONFIG_ARCH="p2"
CONFIG_ARCH_P2=y
CONFIG_ARCH_SETJMP_H=y
CONFIG_ARCH_CHIP="p2x8c4m64p"
CONFIG_ARCH_CHIP_P2X8C4M64P=y
CONFIG_ARCH_BOARD="p2-ec32mb"
CONFIG_ARCH_BOARD_P2_EC32MB=y
CONFIG_ARCH_TOOLCHAIN_CLANG=y
# CONFIG_ARCH_LEDS is not set

CONFIG_BOARDCTL=y
CONFIG_BOARDCTL_RESET=y
CONFIG_BOARD_LATE_INITIALIZE=y
CONFIG_BCH=y
CONFIG_BUILD_FLAT=y
CONFIG_BUILTIN=y
CONFIG_BUILTIN_COMPILER_RT=y
CONFIG_DEBUG_FEATURES=y
CONFIG_DEBUG_CUSTOMOPT=y
CONFIG_DEBUG_OPTLEVEL="-Oz"
CONFIG_DEFAULT_SMALL=y
# CONFIG_DISABLE_PSEUDOFS_OPERATIONS is not set
CONFIG_DEFAULT_TASK_STACKSIZE=2048
CONFIG_DEV_CONSOLE=y
# CONFIG_DISABLE_ENVIRON is not set
CONFIG_DISABLE_MQUEUE=y
CONFIG_DISABLE_POSIX_TIMERS=y
CONFIG_DISABLE_PTHREAD=y
CONFIG_ENABLE_ALL_SIGNALS=y
CONFIG_ETC_ROMFS=y
CONFIG_FILE_STREAM=y
CONFIG_FS_ROMFS=y
CONFIG_INIT_ENTRYPOINT="nsh_main"
CONFIG_INIT_STACKSIZE=4096
CONFIG_INTELHEX_BINARY=n
CONFIG_LIBC_ARCH_ATOMIC=y
CONFIG_LIBC_TEMPBUFFER=y
CONFIG_LIBC_TEMPBUFFER_MALLOC=y
CONFIG_LIBM=y
CONFIG_LIB_COMPILER_RT_VERSION="17.0.1"
CONFIG_LINE_MAX=128
CONFIG_NFILE_DESCRIPTORS=16
CONFIG_NFILE_DESCRIPTORS_PER_BLOCK=8
CONFIG_NSH_ARCHINIT=n
CONFIG_NSH_BUILTIN_APPS=y
CONFIG_NSH_CLE=y
CONFIG_NSH_NESTDEPTH=8
CONFIG_NSH_CMDOPT_HEXDUMP=y
# CONFIG_NSH_DISABLE_CAT is not set
# CONFIG_NSH_DISABLE_CP is not set
# CONFIG_NSH_DISABLE_ECHO is not set
# CONFIG_NSH_DISABLE_FREE is not set
# CONFIG_NSH_DISABLE_HEXDUMP is not set
# CONFIG_NSH_DISABLE_KILL is not set
# CONFIG_NSH_DISABLE_LS is not set
# CONFIG_NSH_DISABLE_MKDIR is not set
# CONFIG_NSH_DISABLE_MOUNT is not set
# CONFIG_NSH_DISABLE_PS is not set
# CONFIG_NSH_DISABLE_PWD is not set
# CONFIG_NSH_DISABLE_RM is not set
# CONFIG_NSH_DISABLE_TEST is not set
# CONFIG_NSH_DISABLE_UMOUNT is not set
# CONFIG_NSH_DISABLESCRIPT is not set
# CONFIG_NSH_DISABLE_ITEF is not set
# CONFIG_NSH_DISABLE_REBOOT is not set
CONFIG_NSH_FILEIOSIZE=512
CONFIG_P2_BOOT_TRACE=y
CONFIG_P2_EDGE_BASE_IMAGE=y
CONFIG_PREALLOC_TIMERS=4
CONFIG_RAM_SIZE=524288
CONFIG_RAW_BINARY=y
CONFIG_RR_INTERVAL=200
CONFIG_SCHED_HPWORK=n
CONFIG_SCHED_WAITPID=y
CONFIG_SERIAL_TERMIOS=y
CONFIG_SIG_DEFAULT=y
CONFIG_SIG_SIGKILL_ACTION=y
CONFIG_START_DAY=1
CONFIG_START_MONTH=1
CONFIG_START_YEAR=2026
CONFIG_SYSTEM_NSH=y
CONFIG_SYSTEM_CLE=y
CONFIG_SYSTEM_CLE_CMD_HISTORY=y
CONFIG_SYSTEM_CLE_CMD_HISTORY_LEN=8
CONFIG_SYSTEM_CLE_CMD_HISTORY_LINELEN=80
CONFIG_SYSTEM_TERMCURSES_ESCDELAY_MS=30
CONFIG_SYSTEM_VI=y
CONFIG_SYSTEM_VI_COLS=80
CONFIG_SYSTEM_VI_ROWS=24
CONFIG_SYSTEM_VI_STACKSIZE=4096
# CONFIG_SYSTEM_DD is not set
CONFIG_TTY_SIGINT=y
CONFIG_TTY_SIGINT_CHAR=0x03
CONFIG_UART0_BAUD=230400
CONFIG_UART0_SERIAL_CONSOLE=y

CONFIG_USERLED=y
CONFIG_USERLED_LOWER=y
CONFIG_EXAMPLES_LEDS=y
CONFIG_EXAMPLES_LEDS_LEDSET=0x03

CONFIG_P2_SMARTPIN=y
CONFIG_P2_EC32MB_PSRAM=y
CONFIG_P2_EC32MB_PSRAM_COG_STACKSIZE=3072
CONFIG_P2_EC32MB_PSRAM_MAX_REQUEST=65536
CONFIG_P2_EC32MB_PSRAM_TIMEOUT_TICKS=500
CONFIG_P2_EC32MB_PSRAM_CANCEL_GRACE_TICKS=100

CONFIG_P2_STORAGE=y
CONFIG_P2_EC32MB_STORAGE_BINDINGS=y
CONFIG_P2_EC32MB_W25_PROBE_FREQUENCY=400000
CONFIG_P2_EC32MB_FLASHBOOT=y
CONFIG_P2_EC32MB_SDCARD_AUTOMOUNT=y
CONFIG_P2_STORAGE_LOCK_TIMEOUT_TICKS=500
CONFIG_P2_STORAGE_MAX_FREQUENCY=2000000
CONFIG_MTD=y
CONFIG_MTD_PARTITION=y
CONFIG_MTD_SMART=y
CONFIG_MTD_SMART_MINIMIZE_RAM=y
CONFIG_MTD_SMART_SECTOR_CACHE_SIZE=2048
CONFIG_MTD_SMART_SECTOR_PACK_COUNTS=y
CONFIG_MTD_W25=y
CONFIG_W25_SPIFREQUENCY=2000000
CONFIG_W25_SPIMODE=3
CONFIG_MMCSD=y
CONFIG_MMCSD_SPI=y
# CONFIG_MMCSD_HAVE_CARDDETECT is not set
# CONFIG_MMCSD_HAVE_WRITEPROTECT is not set
# CONFIG_MMCSD_READONLY is not set
CONFIG_MMCSD_IDMODE_CLOCK=400000
CONFIG_MMCSD_SPICLOCK=2000000
CONFIG_MMCSD_SPIMODE=0
CONFIG_FS_SMARTFS=y
CONFIG_FS_FAT=y
CONFIG_FAT_LCNAMES=y
CONFIG_FAT_LFN=y
# CONFIG_FSUTILS_MKFATFS is not set
# CONFIG_FSUTILS_MKSMARTFS is not set

CONFIG_TESTING_P2STORAGE=y
# CONFIG_TESTING_P2STORAGE_DESTRUCTIVE is not set
CONFIG_TESTING_P2STORAGE_FLASH_PREMOUNTED=y
CONFIG_TESTING_P2STORAGE_FLASH_DEVPATH="/dev/smart0"
CONFIG_TESTING_P2STORAGE_FLASH_MOUNTPOINT="/mnt/flash"
CONFIG_TESTING_P2STORAGE_SD_DEVPATH="/dev/mmcsd0"
CONFIG_TESTING_P2STORAGE_SD_MOUNTPOINT="/mnt/sd"
CONFIG_TESTING_P2STORAGE_RECORD_SIZE=256
CONFIG_TESTING_P2STORAGE_STREAM_SIZE=1048576

CONFIG_INTERPRETERS_BERRY=y
CONFIG_INTERPRETERS_BERRY_PRIORITY=100
CONFIG_INTERPRETERS_BERRY_STACKSIZE=16384
```

## boards/p2/p2x8c4m64p/p2-ec32mb/configs/berry/defconfig
```kconfig
CONFIG_ARCH="p2"
CONFIG_ARCH_P2=y
CONFIG_ARCH_CHIP="p2x8c4m64p"
CONFIG_ARCH_CHIP_P2X8C4M64P=y
CONFIG_ARCH_BOARD="p2-ec32mb"
CONFIG_ARCH_BOARD_P2_EC32MB=y
CONFIG_ARCH_TOOLCHAIN_CLANG=y
CONFIG_ARCH_SETJMP_H=y
# CONFIG_ARCH_LEDS is not set

CONFIG_BOARDCTL=y
CONFIG_BOARDCTL_RESET=y
CONFIG_BOARD_LATE_INITIALIZE=y
CONFIG_BCH=y
# CONFIG_BINFMT_DISABLE is not set
CONFIG_BUILD_FLAT=y
CONFIG_BUILTIN=y
CONFIG_BUILTIN_COMPILER_RT=y
CONFIG_DEBUG_FEATURES=y
CONFIG_DEBUG_CUSTOMOPT=y
CONFIG_DEBUG_OPTLEVEL="-Oz"
CONFIG_DEFAULT_SMALL=y
CONFIG_DEFAULT_TASK_STACKSIZE=2048
CONFIG_DEV_CONSOLE=y
# CONFIG_DISABLE_ENVIRON is not set
CONFIG_DISABLE_MQUEUE=y
CONFIG_DISABLE_POSIX_TIMERS=y
CONFIG_DISABLE_PTHREAD=y
CONFIG_ELF=y
CONFIG_ELF_STACKSIZE=16384
CONFIG_ETC_ROMFS=y
CONFIG_FILE_STREAM=y
CONFIG_FS_ROMFS=y
CONFIG_INIT_ENTRYPOINT="nsh_main"
CONFIG_INIT_STACKSIZE=8192
CONFIG_INTELHEX_BINARY=n
CONFIG_LIBC_ARCH_ATOMIC=y
CONFIG_LIBC_ENVPATH=y
CONFIG_LIBC_EXECFUNCS=y
CONFIG_LIBC_TEMPBUFFER=y
CONFIG_LIBC_TEMPBUFFER_MALLOC=y
CONFIG_LIBM=y
CONFIG_LIB_COMPILER_RT_VERSION="17.0.1"
CONFIG_MODULES=y
CONFIG_EXECFUNCS_HAVE_SYMTAB=y
# CONFIG_EXECFUNCS_SYSTEM_SYMTAB is not set
CONFIG_PATH_INITIAL="/mnt/flash/berry:/mnt/sd/berry-p2"
CONFIG_NFILE_DESCRIPTORS=16
CONFIG_NFILE_DESCRIPTORS_PER_BLOCK=8
CONFIG_NSH_ARCHINIT=n
CONFIG_NSH_BUILTIN_APPS=y
CONFIG_NSH_CLE=y
CONFIG_NSH_FILE_APPS=y
CONFIG_NSH_FILEIOSIZE=512
CONFIG_P2_BOOT_TRACE=y
CONFIG_PREALLOC_TIMERS=4
CONFIG_RAM_SIZE=524288
CONFIG_RAW_BINARY=y
CONFIG_RR_INTERVAL=200
CONFIG_SCHED_HPWORK=y
CONFIG_SCHED_HPWORKPRIORITY=224
CONFIG_SCHED_HPWORKSTACKSIZE=2048
CONFIG_SCHED_WAITPID=y
CONFIG_START_DAY=1
CONFIG_START_MONTH=1
CONFIG_START_YEAR=2026
CONFIG_SYSTEM_NSH=y
CONFIG_SYSTEM_CLE=y
CONFIG_SYSTEM_CLE_CMD_HISTORY=y
CONFIG_SYSTEM_CLE_CMD_HISTORY_LEN=8
CONFIG_SYSTEM_CLE_CMD_HISTORY_LINELEN=80
CONFIG_SYSTEM_P2RECV=y
CONFIG_SYSTEM_P2RECV_STACKSIZE=3072
CONFIG_SYSTEM_P2RECV_MAXSIZE=1048576
CONFIG_SYSTEM_SYSTEM=y
CONFIG_SYSTEM_VI=y
CONFIG_SYSTEM_VI_COLS=80
CONFIG_SYSTEM_VI_ROWS=24
CONFIG_SYSTEM_VI_STACKSIZE=4096
# CONFIG_SYSTEM_DD is not set
CONFIG_UART0_BAUD=230400
CONFIG_UART0_SERIAL_CONSOLE=y

CONFIG_P2_SMARTPIN=y
CONFIG_P2_EC32MB_PSRAM=y
CONFIG_P2_EC32MB_PSRAM_COG_STACKSIZE=3072
CONFIG_P2_EC32MB_PSRAM_MAX_REQUEST=65536
CONFIG_P2_EC32MB_PSRAM_TIMEOUT_TICKS=500
CONFIG_P2_EC32MB_PSRAM_CANCEL_GRACE_TICKS=100

CONFIG_SPI=y
CONFIG_SPI_BITBANG=y
CONFIG_SPI_BITBANG_VARWIDTH=y
CONFIG_SPI_CMDDATA=y
CONFIG_SPI_DRIVER=y
CONFIG_SPI_EXCHANGE=y
CONFIG_P2_EC32MB_SPI=y
CONFIG_P2_EC32MB_SPI_MOSI_PIN=6
CONFIG_P2_EC32MB_SPI_MISO_PIN=7
CONFIG_P2_EC32MB_SPI_SCK_PIN=8
CONFIG_P2_EC32MB_SPI_CS_PIN=11
CONFIG_P2_EC32MB_SPI_MAX_FREQUENCY=5000000

CONFIG_P2_STORAGE=y
CONFIG_P2_EC32MB_STORAGE_BINDINGS=y
CONFIG_P2_EC32MB_W25_PROBE_FREQUENCY=400000
CONFIG_P2_EC32MB_FLASHBOOT=y
CONFIG_P2_EC32MB_SDCARD_AUTOMOUNT=y
CONFIG_P2_STORAGE_LOCK_TIMEOUT_TICKS=500
CONFIG_P2_STORAGE_MAX_FREQUENCY=2000000
CONFIG_MTD=y
CONFIG_MTD_PARTITION=y
CONFIG_MTD_SMART=y
CONFIG_MTD_W25=y
CONFIG_W25_SPIFREQUENCY=2000000
CONFIG_W25_SPIMODE=3
CONFIG_MMCSD=y
CONFIG_MMCSD_SPI=y
# CONFIG_MMCSD_HAVE_CARDDETECT is not set
# CONFIG_MMCSD_HAVE_WRITEPROTECT is not set
# CONFIG_MMCSD_READONLY is not set
CONFIG_MMCSD_IDMODE_CLOCK=400000
CONFIG_MMCSD_SPICLOCK=2000000
CONFIG_MMCSD_SPIMODE=0
CONFIG_FS_SMARTFS=y
CONFIG_FS_FAT=y
CONFIG_FAT_LCNAMES=y
CONFIG_FAT_LFN=y
# CONFIG_FSUTILS_MKFATFS is not set
# CONFIG_FSUTILS_MKSMARTFS is not set

CONFIG_LCD=y
CONFIG_LCD_DEV=y
CONFIG_LCD_ILI9341=y
CONFIG_LCD_ILI9341_BGR=y
CONFIG_LCD_ILI9341_IFACE0=y
CONFIG_LCD_ILI9341_IFACE0_WIDTH=240
CONFIG_LCD_ILI9341_IFACE0_HEIGHT=320
CONFIG_LCD_ILI9341_IFACE0_PORTRAIT=y
CONFIG_LCD_ILI9341_IFACE0_RGB565=y
CONFIG_LCD_ILI9341_NINTERFACES=1
CONFIG_LCD_MAXPOWER=1

CONFIG_INPUT=y
CONFIG_INPUT_ADS7843E=y
CONFIG_ADS7843E_DEVMINOR=0
CONFIG_ADS7843E_FREQUENCY=500000
CONFIG_ADS7843E_SPIDEV=0
CONFIG_ADS7843E_SPIMODE=0
CONFIG_ADS7843E_THRESHX=13
CONFIG_ADS7843E_THRESHY=17

CONFIG_P2_EC32MB_ILI9341_XPT2046=y
CONFIG_P2_EC32MB_ILI9341_RESET_PIN=9
CONFIG_P2_EC32MB_ILI9341_DC_PIN=10
CONFIG_P2_EC32MB_ILI9341_FREQUENCY=5000000
CONFIG_P2_EC32MB_XPT2046_CS_PIN=12
CONFIG_P2_EC32MB_XPT2046_PEN_PIN=14
CONFIG_P2_EC32MB_TOUCHPEN_GPIO_ONLY=y
CONFIG_P2_EC32MB_TOUCHPEN_FLOAT_INPUT=y

CONFIG_GRAPHICS_LVGL=y
CONFIG_LV_CONF_MINIMAL=y
CONFIG_LV_COLOR_DEPTH_16=y
CONFIG_LV_USE_CLIB_MALLOC=y
CONFIG_LV_USE_CLIB_STRING=y
CONFIG_LV_USE_CLIB_SPRINTF=y
CONFIG_LV_USE_DRAW_SW=y
CONFIG_LV_DRAW_SW_SUPPORT_RGB565=y
# CONFIG_LV_DRAW_SW_SUPPORT_RGB565A8 is not set
# CONFIG_LV_DRAW_SW_SUPPORT_RGB888 is not set
# CONFIG_LV_DRAW_SW_SUPPORT_XRGB8888 is not set
# CONFIG_LV_DRAW_SW_SUPPORT_ARGB8888 is not set
# CONFIG_LV_DRAW_SW_SUPPORT_L8 is not set
# CONFIG_LV_DRAW_SW_SUPPORT_AL88 is not set
# CONFIG_LV_DRAW_SW_SUPPORT_A8 is not set
# CONFIG_LV_DRAW_SW_SUPPORT_I1 is not set
# CONFIG_LV_DRAW_SW_COMPLEX is not set
CONFIG_LV_FONT_UNSCII_8=y
CONFIG_LV_FONT_DEFAULT_UNSCII_8=y
CONFIG_LV_USE_NUTTX=y
CONFIG_LV_USE_NUTTX_LCD=y
CONFIG_LV_NUTTX_LCD_CUSTOM_BUFFER=y
CONFIG_LV_NUTTX_LCD_BUFFER_SIZE=20
CONFIG_LV_USE_THEME_SIMPLE=y
CONFIG_LV_USE_BAR=y
CONFIG_LV_USE_BUTTON=y
CONFIG_LV_USE_SLIDER=y
CONFIG_LV_USE_SWITCH=y

CONFIG_INTERPRETERS_BERRY=m
CONFIG_INTERPRETERS_BERRY_PRIORITY=100
CONFIG_INTERPRETERS_BERRY_STACKSIZE=16384
CONFIG_INTERPRETERS_BERRY_LVGL=y
CONFIG_INTERPRETERS_BERRY_LVGL_GLOBAL=y
CONFIG_INTERPRETERS_BERRY_LVGL_DEVPATH="/dev/lcd0"
CONFIG_INTERPRETERS_BERRY_LVGL_P2_TOUCH=y
CONFIG_INTERPRETERS_BERRY_LVGL_P2_RAW_X_LEFT=297
CONFIG_INTERPRETERS_BERRY_LVGL_P2_RAW_X_RIGHT=1764
CONFIG_INTERPRETERS_BERRY_LVGL_P2_RAW_Y_TOP=216
CONFIG_INTERPRETERS_BERRY_LVGL_P2_RAW_Y_BOTTOM=1812
CONFIG_INTERPRETERS_BERRY_LVGL_P2_CAL_MARGIN=24
CONFIG_INTERPRETERS_BERRY_LVGL_P2_PRESSURE_MIN=64
```

## boards/p2/p2x8c4m64p/p2-ec32mb/configs/berrymgr/defconfig
```kconfig
CONFIG_ARCH="p2"
CONFIG_ARCH_P2=y
CONFIG_ARCH_CHIP="p2x8c4m64p"
CONFIG_ARCH_CHIP_P2X8C4M64P=y
CONFIG_ARCH_BOARD="p2-ec32mb"
CONFIG_ARCH_BOARD_P2_EC32MB=y
CONFIG_ARCH_TOOLCHAIN_CLANG=y
# CONFIG_ARCH_LEDS is not set

CONFIG_BOARDCTL=y
CONFIG_BOARDCTL_RESET=y
CONFIG_BOARD_LATE_INITIALIZE=y
CONFIG_BCH=y
CONFIG_BUILD_FLAT=y
CONFIG_BUILTIN=y
CONFIG_DEBUG_FEATURES=y
CONFIG_DEBUG_CUSTOMOPT=y
CONFIG_DEBUG_OPTLEVEL="-Oz"
CONFIG_DEFAULT_SMALL=y
# CONFIG_DISABLE_PSEUDOFS_OPERATIONS is not set
CONFIG_DEFAULT_TASK_STACKSIZE=2048
CONFIG_DEV_CONSOLE=y
# CONFIG_DISABLE_ENVIRON is not set
CONFIG_DISABLE_MQUEUE=y
CONFIG_DISABLE_POSIX_TIMERS=y
CONFIG_DISABLE_PTHREAD=y
CONFIG_ENABLE_ALL_SIGNALS=y
CONFIG_ETC_ROMFS=y
CONFIG_FILE_STREAM=y
CONFIG_FS_ROMFS=y
CONFIG_INIT_ENTRYPOINT="nsh_main"
CONFIG_INIT_STACKSIZE=4096
CONFIG_INTELHEX_BINARY=n
CONFIG_LIBC_ARCH_ATOMIC=y
CONFIG_LIBC_TEMPBUFFER=y
CONFIG_LIBC_TEMPBUFFER_MALLOC=y
CONFIG_LIBM_NONE=y
CONFIG_LINE_MAX=128
CONFIG_NFILE_DESCRIPTORS=16
CONFIG_NFILE_DESCRIPTORS_PER_BLOCK=8
CONFIG_NSH_ARCHINIT=n
CONFIG_NSH_BUILTIN_APPS=y
CONFIG_NSH_CLE=y
CONFIG_NSH_NESTDEPTH=8
CONFIG_NSH_CMDOPT_HEXDUMP=y
# CONFIG_NSH_DISABLE_CAT is not set
# CONFIG_NSH_DISABLE_CP is not set
# CONFIG_NSH_DISABLE_ECHO is not set
# CONFIG_NSH_DISABLE_HEXDUMP is not set
# CONFIG_NSH_DISABLE_LS is not set
# CONFIG_NSH_DISABLE_MKDIR is not set
# CONFIG_NSH_DISABLE_MOUNT is not set
# CONFIG_NSH_DISABLE_PWD is not set
# CONFIG_NSH_DISABLE_RM is not set
# CONFIG_NSH_DISABLE_TEST is not set
# CONFIG_NSH_DISABLE_UMOUNT is not set
# CONFIG_NSH_DISABLESCRIPT is not set
# CONFIG_NSH_DISABLE_ITEF is not set
# CONFIG_NSH_DISABLE_REBOOT is not set
CONFIG_NSH_FILEIOSIZE=512
CONFIG_P2_BOOT_TRACE=y
CONFIG_PREALLOC_TIMERS=4
CONFIG_RAM_SIZE=524288
CONFIG_RAW_BINARY=y
CONFIG_RR_INTERVAL=200
CONFIG_SCHED_HPWORK=y
CONFIG_SCHED_HPWORKPRIORITY=224
CONFIG_SCHED_HPWORKSTACKSIZE=2048
CONFIG_SCHED_WAITPID=y
CONFIG_SIG_DEFAULT=y
CONFIG_SIG_SIGKILL_ACTION=y
CONFIG_START_DAY=1
CONFIG_START_MONTH=1
CONFIG_START_YEAR=2026
CONFIG_SYSTEM_NSH=y
CONFIG_SYSTEM_CLE=y
CONFIG_SYSTEM_CLE_CMD_HISTORY=y
CONFIG_SYSTEM_CLE_CMD_HISTORY_LEN=8
CONFIG_SYSTEM_CLE_CMD_HISTORY_LINELEN=80
CONFIG_SYSTEM_P2BANK=y
CONFIG_SYSTEM_P2BANK_STACKSIZE=3072
CONFIG_SYSTEM_P2BANK_BUFSIZE=4096
CONFIG_SYSTEM_P2BANK_DEFAULT_BANK="/mnt/flash/banks/berry.bin"
CONFIG_SYSTEM_P2RECV=y
CONFIG_SYSTEM_P2RECV_STACKSIZE=3072
CONFIG_SYSTEM_P2RECV_MAXSIZE=1048576
CONFIG_SYSTEM_TERMCURSES_ESCDELAY_MS=30
CONFIG_SYSTEM_VI=y
CONFIG_SYSTEM_VI_COLS=80
CONFIG_SYSTEM_VI_ROWS=24
CONFIG_SYSTEM_VI_STACKSIZE=4096
# CONFIG_SYSTEM_DD is not set
CONFIG_TTY_SIGINT=y
CONFIG_TTY_SIGINT_CHAR=0x03
CONFIG_UART0_BAUD=230400
CONFIG_UART0_SERIAL_CONSOLE=y

CONFIG_P2_SMARTPIN=y
CONFIG_P2_EC32MB_PSRAM=y
CONFIG_P2_EC32MB_PSRAM_COG_STACKSIZE=3072
CONFIG_P2_EC32MB_PSRAM_MAX_REQUEST=65536
CONFIG_P2_EC32MB_PSRAM_TIMEOUT_TICKS=500
CONFIG_P2_EC32MB_PSRAM_CANCEL_GRACE_TICKS=100
CONFIG_TESTING_P2PSRAM=y
CONFIG_TESTING_P2PSRAM_STACKSIZE=4096
CONFIG_TESTING_P2PSRAM_WORKER_STACKSIZE=2048
CONFIG_TESTING_P2PSRAM_RANDOM_COUNT=1024

CONFIG_SPI=y
CONFIG_SPI_BITBANG=y
CONFIG_SPI_BITBANG_VARWIDTH=y
CONFIG_SPI_CMDDATA=y
CONFIG_SPI_DRIVER=y
CONFIG_SPI_EXCHANGE=y
CONFIG_P2_EC32MB_SPI=y
CONFIG_P2_EC32MB_SPI_MOSI_PIN=6
CONFIG_P2_EC32MB_SPI_MISO_PIN=7
CONFIG_P2_EC32MB_SPI_SCK_PIN=8
CONFIG_P2_EC32MB_SPI_CS_PIN=11
CONFIG_P2_EC32MB_SPI_MAX_FREQUENCY=5000000

CONFIG_P2_STORAGE=y
CONFIG_P2_EC32MB_STORAGE_BINDINGS=y
CONFIG_P2_EC32MB_W25_PROBE_FREQUENCY=400000
CONFIG_P2_EC32MB_FLASHBOOT=y
CONFIG_P2_EC32MB_SDCARD_AUTOMOUNT=y
CONFIG_P2_STORAGE_LOCK_TIMEOUT_TICKS=500
CONFIG_P2_STORAGE_MAX_FREQUENCY=2000000
CONFIG_MTD=y
CONFIG_MTD_PARTITION=y
CONFIG_MTD_SMART=y
CONFIG_MTD_W25=y
CONFIG_W25_SPIFREQUENCY=2000000
CONFIG_W25_SPIMODE=3
CONFIG_MMCSD=y
CONFIG_MMCSD_SPI=y
# CONFIG_MMCSD_HAVE_CARDDETECT is not set
# CONFIG_MMCSD_HAVE_WRITEPROTECT is not set
# CONFIG_MMCSD_READONLY is not set
CONFIG_MMCSD_IDMODE_CLOCK=400000
CONFIG_MMCSD_SPICLOCK=2000000
CONFIG_MMCSD_SPIMODE=0
CONFIG_FS_SMARTFS=y
CONFIG_FS_FAT=y
CONFIG_FAT_LCNAMES=y
CONFIG_FAT_LFN=y
# CONFIG_FSUTILS_MKFATFS is not set
# CONFIG_FSUTILS_MKSMARTFS is not set

CONFIG_LCD=y
CONFIG_LCD_DEV=y
CONFIG_LCD_ILI9341=y
CONFIG_LCD_ILI9341_BGR=y
CONFIG_LCD_ILI9341_IFACE0=y
CONFIG_LCD_ILI9341_IFACE0_WIDTH=240
CONFIG_LCD_ILI9341_IFACE0_HEIGHT=320
CONFIG_LCD_ILI9341_IFACE0_PORTRAIT=y
CONFIG_LCD_ILI9341_IFACE0_RGB565=y
CONFIG_LCD_ILI9341_NINTERFACES=1
CONFIG_LCD_MAXPOWER=1

CONFIG_INPUT=y
CONFIG_INPUT_ADS7843E=y
CONFIG_ADS7843E_DEVMINOR=0
CONFIG_ADS7843E_FREQUENCY=500000
CONFIG_ADS7843E_SPIDEV=0
CONFIG_ADS7843E_SPIMODE=0
CONFIG_ADS7843E_THRESHX=13
CONFIG_ADS7843E_THRESHY=17

CONFIG_P2_EC32MB_ILI9341_XPT2046=y
CONFIG_P2_EC32MB_ILI9341_RESET_PIN=9
CONFIG_P2_EC32MB_ILI9341_DC_PIN=10
CONFIG_P2_EC32MB_ILI9341_FREQUENCY=5000000
CONFIG_P2_EC32MB_XPT2046_CS_PIN=12
CONFIG_P2_EC32MB_XPT2046_PEN_PIN=14
CONFIG_P2_EC32MB_TOUCHPEN_GPIO_ONLY=y
CONFIG_P2_EC32MB_TOUCHPEN_FLOAT_INPUT=y
```
