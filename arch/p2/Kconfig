## boards/p2/p2x8c4m64p/p2-ec32mb/configs/clock/defconfig
```kconfig
CONFIG_ARCH="p2"
CONFIG_ARCH_P2=y
CONFIG_ARCH_CHIP="p2x8c4m64p"
CONFIG_ARCH_CHIP_P2X8C4M64P=y
CONFIG_ARCH_BOARD="p2-ec32mb"
CONFIG_ARCH_BOARD_P2_EC32MB=y
CONFIG_ARCH_TOOLCHAIN_CLANG=y
CONFIG_BUILD_FLAT=y
CONFIG_DEFAULT_TASK_STACKSIZE=2048
CONFIG_DEV_CONSOLE=y
CONFIG_DISABLE_ENVIRON=y
CONFIG_DISABLE_MOUNTPOINT=y
CONFIG_DISABLE_MQUEUE=y
CONFIG_DISABLE_POSIX_TIMERS=y
CONFIG_INIT_ENTRYPOINT="p2clock_main"
CONFIG_INIT_PRIORITY=100
CONFIG_INIT_STACKSIZE=2048
CONFIG_INTELHEX_BINARY=n
CONFIG_LIBC_ARCH_ATOMIC=y
CONFIG_LIBM_NONE=y
CONFIG_P2_BOOT_TRACE=y
CONFIG_P2_SYSCLK_HZ=180000000
CONFIG_P2_XTAL_HZ=20000000
CONFIG_RAM_SIZE=524288
CONFIG_RAW_BINARY=y
CONFIG_RR_INTERVAL=200
CONFIG_SCHED_HPWORK=n
CONFIG_START_DAY=1
CONFIG_START_MONTH=1
CONFIG_START_YEAR=2026
CONFIG_TESTING_P2CLOCK=y
CONFIG_UART0_BAUD=230400
CONFIG_UART0_SERIAL_CONSOLE=y
```

## boards/p2/p2x8c4m64p/p2-ec32mb/configs/flashboot/defconfig
```kconfig
CONFIG_ARCH="p2"
CONFIG_ARCH_P2=y
CONFIG_ARCH_CHIP="p2x8c4m64p"
CONFIG_ARCH_CHIP_P2X8C4M64P=y
CONFIG_ARCH_BOARD="p2-ec32mb"
CONFIG_ARCH_BOARD_P2_EC32MB=y
CONFIG_ARCH_TOOLCHAIN_CLANG=y
CONFIG_BOARDCTL=y
CONFIG_BOARDCTL_RESET=y
CONFIG_BOARD_LATE_INITIALIZE=y
CONFIG_BUILD_FLAT=y
CONFIG_BUILTIN=y
CONFIG_DEBUG_FEATURES=y
CONFIG_DEV_CONSOLE=y
CONFIG_DISABLE_MQUEUE=y
CONFIG_DISABLE_POSIX_TIMERS=y
CONFIG_ETC_ROMFS=y
CONFIG_FS_ROMFS=y
CONFIG_INIT_ENTRYPOINT="nsh_main"
CONFIG_INTELHEX_BINARY=n
CONFIG_LIBC_ARCH_ATOMIC=y
CONFIG_LIBM_NONE=y
CONFIG_NFILE_DESCRIPTORS=8
CONFIG_NSH_ARCHINIT=n
CONFIG_LINE_MAX=128
CONFIG_NSH_BUILTIN_APPS=y
CONFIG_NSH_FILEIOSIZE=512
CONFIG_NSH_READLINE=y
CONFIG_PREALLOC_TIMERS=2
CONFIG_RAM_SIZE=524288
CONFIG_RAW_BINARY=y
CONFIG_P2_BOOT_TRACE=y
CONFIG_RR_INTERVAL=200
CONFIG_SCHED_HPWORK=n
CONFIG_START_DAY=1
CONFIG_START_MONTH=1
CONFIG_START_YEAR=2026
CONFIG_SYSTEM_NSH=y
CONFIG_UART0_BAUD=230400
CONFIG_UART0_SERIAL_CONSOLE=y
CONFIG_P2_STORAGE=y
CONFIG_P2_EC32MB_STORAGE_BINDINGS=y
CONFIG_P2_EC32MB_W25_PROBE_FREQUENCY=400000
CONFIG_P2_EC32MB_FLASHBOOT=y
CONFIG_P2_STORAGE_LOCK_TIMEOUT_TICKS=500
CONFIG_P2_STORAGE_MAX_FREQUENCY=2000000
CONFIG_MTD=y
CONFIG_MTD_PARTITION=y
CONFIG_MTD_SMART=y
CONFIG_MTD_W25=y
CONFIG_W25_SPIFREQUENCY=2000000
CONFIG_W25_SPIMODE=3
CONFIG_MMCSD=y
CONFIG_MMCSD_SPI=y
# CONFIG_MMCSD_HAVE_CARDDETECT is not set
# CONFIG_MMCSD_HAVE_WRITEPROTECT is not set
# CONFIG_MMCSD_READONLY is not set
CONFIG_MMCSD_IDMODE_CLOCK=400000
CONFIG_MMCSD_SPICLOCK=2000000
CONFIG_MMCSD_SPIMODE=0
CONFIG_FS_SMARTFS=y
CONFIG_FS_FAT=y
# CONFIG_FSUTILS_MKFATFS is not set
# CONFIG_FSUTILS_MKSMARTFS is not set
CONFIG_TESTING_P2STORAGE=y
# CONFIG_TESTING_P2STORAGE_DESTRUCTIVE is not set
CONFIG_TESTING_P2STORAGE_FLASH_PREMOUNTED=y
CONFIG_TESTING_P2STORAGE_FLASH_DEVPATH="/dev/smart0"
CONFIG_TESTING_P2STORAGE_FLASH_MOUNTPOINT="/mnt/flash"
CONFIG_TESTING_P2STORAGE_SD_DEVPATH="/dev/mmcsd0"
CONFIG_TESTING_P2STORAGE_SD_MOUNTPOINT="/mnt/sd"
CONFIG_TESTING_P2STORAGE_RECORD_SIZE=256
CONFIG_TESTING_P2STORAGE_STREAM_SIZE=1048576
# CONFIG_SYSTEM_DD is not set
```

## boards/p2/p2x8c4m64p/p2-ec32mb/configs/i2c/defconfig
```kconfig
CONFIG_ARCH="p2"
CONFIG_ARCH_P2=y
CONFIG_ARCH_CHIP="p2x8c4m64p"
CONFIG_ARCH_CHIP_P2X8C4M64P=y
CONFIG_ARCH_BOARD="p2-ec32mb"
CONFIG_ARCH_BOARD_P2_EC32MB=y
CONFIG_ARCH_TOOLCHAIN_CLANG=y
CONFIG_BOARDCTL=y
CONFIG_BOARD_LATE_INITIALIZE=y
CONFIG_BUILD_FLAT=y
CONFIG_DEFAULT_TASK_STACKSIZE=2048
CONFIG_DEBUG_FEATURES=y
CONFIG_DEV_CONSOLE=y
CONFIG_DISABLE_ENVIRON=y
CONFIG_DISABLE_MOUNTPOINT=y
CONFIG_DISABLE_MQUEUE=y
CONFIG_DISABLE_POSIX_TIMERS=y
CONFIG_I2C=y
CONFIG_I2C_BITBANG=y
CONFIG_I2C_BITBANG_CLOCK_STRETCHING=y
CONFIG_I2C_BITBANG_GPIO_OVERHEAD=0
CONFIG_I2C_BITBANG_TIMEOUT=1000
CONFIG_I2C_DRIVER=y
CONFIG_INIT_ENTRYPOINT="p2i2c_main"
CONFIG_INIT_PRIORITY=100
CONFIG_INIT_STACKSIZE=4096
CONFIG_INTELHEX_BINARY=n
CONFIG_LIBC_ARCH_ATOMIC=y
CONFIG_LIBM_NONE=y
CONFIG_NFILE_DESCRIPTORS=4
CONFIG_P2_BOOT_TRACE=y
CONFIG_P2_EC32MB_BMP180=y
CONFIG_P2_EC32MB_I2C=y
CONFIG_P2_EC32MB_I2C_SCL_PIN=25
CONFIG_P2_EC32MB_I2C_SDA_PIN=24
CONFIG_P2_SMARTPIN=y
CONFIG_PREALLOC_TIMERS=2
CONFIG_RAM_SIZE=524288
CONFIG_RAW_BINARY=y
CONFIG_RR_INTERVAL=200
CONFIG_SCHED_HPWORK=n
CONFIG_SENSORS=y
CONFIG_SENSORS_BMP180=y
# CONFIG_SENSORS_BMP180_UORB is not set
CONFIG_SENSORS_USE_B16=y
CONFIG_START_DAY=1
CONFIG_START_MONTH=1
CONFIG_START_YEAR=2026
CONFIG_TESTING_P2I2C=y
CONFIG_UART0_BAUD=230400
CONFIG_UART0_SERIAL_CONSOLE=y
```

## boards/p2/p2x8c4m64p/p2-ec32mb/configs/lvgl/defconfig
```kconfig
CONFIG_ARCH="p2"
CONFIG_ARCH_P2=y
CONFIG_ARCH_CHIP="p2x8c4m64p"
CONFIG_ARCH_CHIP_P2X8C4M64P=y
CONFIG_ARCH_BOARD="p2-ec32mb"
CONFIG_ARCH_BOARD_P2_EC32MB=y
CONFIG_ARCH_TOOLCHAIN_CLANG=y
CONFIG_ARCH_SETJMP_H=y
# CONFIG_ARCH_LEDS is not set
CONFIG_BOARDCTL=y
CONFIG_BOARD_LATE_INITIALIZE=y
CONFIG_BUILD_FLAT=y
CONFIG_BUILTIN=y
CONFIG_BUILTIN_COMPILER_RT=y
CONFIG_DEBUG_FEATURES=y
CONFIG_DEFAULT_TASK_STACKSIZE=2048
CONFIG_DEV_CONSOLE=y
CONFIG_DISABLE_MQUEUE=y
CONFIG_DISABLE_POSIX_TIMERS=y
CONFIG_ENABLE_ALL_SIGNALS=y
CONFIG_ETC_ROMFS=y
CONFIG_FS_ROMFS=y
CONFIG_INIT_ENTRYPOINT="nsh_main"
CONFIG_INIT_STACKSIZE=16384
CONFIG_INTELHEX_BINARY=n
CONFIG_LIBC_ARCH_ATOMIC=y
CONFIG_LIBM=y
CONFIG_LIB_COMPILER_RT_VERSION="17.0.1"
CONFIG_NFILE_DESCRIPTORS=16
CONFIG_NFILE_DESCRIPTORS_PER_BLOCK=8
CONFIG_NSH_ARCHINIT=n
CONFIG_NSH_BUILTIN_APPS=y
CONFIG_NSH_CLE=y
CONFIG_NSH_FILEIOSIZE=512
CONFIG_P2_BOOT_TRACE=y
CONFIG_PREALLOC_TIMERS=4
CONFIG_RAM_SIZE=524288
CONFIG_RAW_BINARY=y
CONFIG_RR_INTERVAL=200
CONFIG_SCHED_HPWORK=y
CONFIG_SCHED_HPWORKPRIORITY=224
CONFIG_SCHED_HPWORKSTACKSIZE=2048
CONFIG_SCHED_WAITPID=y
CONFIG_START_DAY=1
CONFIG_START_MONTH=1
CONFIG_START_YEAR=2026
CONFIG_SYSTEM_NSH=y
CONFIG_SYSTEM_CLE=y
CONFIG_SYSTEM_CLE_CMD_HISTORY=y
CONFIG_SYSTEM_CLE_CMD_HISTORY_LEN=8
CONFIG_SYSTEM_CLE_CMD_HISTORY_LINELEN=80
CONFIG_SYSTEM_SYSTEM=y
CONFIG_SYSTEM_VI=y
CONFIG_SYSTEM_VI_COLS=80
CONFIG_SYSTEM_VI_ROWS=24
CONFIG_SYSTEM_VI_STACKSIZE=4096
CONFIG_UART0_BAUD=230400
CONFIG_UART0_SERIAL_CONSOLE=y

CONFIG_P2_SMARTPIN=y
CONFIG_SPI=y
CONFIG_SPI_BITBANG=y
CONFIG_SPI_BITBANG_VARWIDTH=y
CONFIG_SPI_CMDDATA=y
CONFIG_SPI_DRIVER=y
CONFIG_SPI_EXCHANGE=y
CONFIG_P2_EC32MB_SPI=y
CONFIG_P2_EC32MB_SPI_MOSI_PIN=6
CONFIG_P2_EC32MB_SPI_MISO_PIN=7
CONFIG_P2_EC32MB_SPI_SCK_PIN=8
CONFIG_P2_EC32MB_SPI_CS_PIN=11
CONFIG_P2_EC32MB_SPI_MAX_FREQUENCY=5000000

CONFIG_P2_STORAGE=y
CONFIG_P2_EC32MB_STORAGE_BINDINGS=y
CONFIG_P2_EC32MB_SDCARD_AUTOMOUNT=y
CONFIG_P2_STORAGE_LOCK_TIMEOUT_TICKS=500
CONFIG_P2_STORAGE_MAX_FREQUENCY=2000000
CONFIG_MMCSD=y
CONFIG_MMCSD_SPI=y
# CONFIG_MMCSD_HAVE_CARDDETECT is not set
# CONFIG_MMCSD_HAVE_WRITEPROTECT is not set
# CONFIG_MMCSD_READONLY is not set
CONFIG_MMCSD_IDMODE_CLOCK=400000
CONFIG_MMCSD_SPICLOCK=2000000
CONFIG_MMCSD_SPIMODE=0
CONFIG_FS_FAT=y
CONFIG_FAT_LCNAMES=y
CONFIG_FAT_LFN=y
# CONFIG_FSUTILS_MKFATFS is not set

CONFIG_LCD=y
CONFIG_LCD_DEV=y
CONFIG_LCD_ILI9341=y
CONFIG_LCD_ILI9341_BGR=y
CONFIG_LCD_ILI9341_IFACE0=y
CONFIG_LCD_ILI9341_IFACE0_WIDTH=240
CONFIG_LCD_ILI9341_IFACE0_HEIGHT=320
CONFIG_LCD_ILI9341_IFACE0_PORTRAIT=y
CONFIG_LCD_ILI9341_IFACE0_RGB565=y
CONFIG_LCD_ILI9341_NINTERFACES=1
CONFIG_LCD_MAXPOWER=1

CONFIG_INPUT=y
CONFIG_INPUT_ADS7843E=y
CONFIG_ADS7843E_DEVMINOR=0
CONFIG_ADS7843E_FREQUENCY=500000
CONFIG_ADS7843E_SPIDEV=0
CONFIG_ADS7843E_SPIMODE=0
CONFIG_ADS7843E_THRESHX=13
CONFIG_ADS7843E_THRESHY=17

CONFIG_P2_EC32MB_ILI9341_XPT2046=y
CONFIG_P2_EC32MB_ILI9341_RESET_PIN=9
CONFIG_P2_EC32MB_ILI9341_DC_PIN=10
CONFIG_P2_EC32MB_ILI9341_FREQUENCY=5000000
CONFIG_P2_EC32MB_XPT2046_CS_PIN=12
CONFIG_P2_EC32MB_XPT2046_PEN_PIN=14
CONFIG_P2_EC32MB_TOUCHPEN_GPIO_ONLY=y
CONFIG_P2_EC32MB_TOUCHPEN_FLOAT_INPUT=y

CONFIG_GRAPHICS_LVGL=y
CONFIG_LV_CONF_MINIMAL=y
CONFIG_LV_COLOR_DEPTH_16=y
CONFIG_LV_USE_BUILTIN_MALLOC=y
CONFIG_LV_MEM_SIZE_KILOBYTES=48
CONFIG_LV_USE_CLIB_STRING=y
CONFIG_LV_USE_CLIB_SPRINTF=y
CONFIG_LV_USE_DRAW_SW=y
CONFIG_LV_DRAW_SW_SUPPORT_RGB565=y
# CONFIG_LV_DRAW_SW_SUPPORT_RGB565A8 is not set
# CONFIG_LV_DRAW_SW_SUPPORT_RGB888 is not set
# CONFIG_LV_DRAW_SW_SUPPORT_XRGB8888 is not set
# CONFIG_LV_DRAW_SW_SUPPORT_ARGB8888 is not set
# CONFIG_LV_DRAW_SW_SUPPORT_L8 is not set
# CONFIG_LV_DRAW_SW_SUPPORT_AL88 is not set
# CONFIG_LV_DRAW_SW_SUPPORT_A8 is not set
# CONFIG_LV_DRAW_SW_SUPPORT_I1 is not set
# CONFIG_LV_DRAW_SW_COMPLEX is not set
CONFIG_LV_FONT_MONTSERRAT_14=y
CONFIG_LV_FONT_DEFAULT_MONTSERRAT_14=y
CONFIG_LV_USE_NUTTX=y
CONFIG_LV_USE_NUTTX_LCD=y
CONFIG_LV_NUTTX_LCD_CUSTOM_BUFFER=y
CONFIG_LV_NUTTX_LCD_BUFFER_SIZE=20
CONFIG_LV_USE_THEME_SIMPLE=y
CONFIG_LV_USE_BAR=y
CONFIG_LV_USE_BUTTON=y
CONFIG_LV_USE_SLIDER=y
CONFIG_LV_USE_SWITCH=y

CONFIG_INTERPRETERS_BERRY=y
CONFIG_INTERPRETERS_BERRY_PRIORITY=100
CONFIG_INTERPRETERS_BERRY_STACKSIZE=32768
CONFIG_INTERPRETERS_BERRY_LVGL=y
CONFIG_INTERPRETERS_BERRY_LVGL_GLOBAL=y
CONFIG_INTERPRETERS_BERRY_LVGL_DEVPATH="/dev/lcd0"
CONFIG_INTERPRETERS_BERRY_LVGL_P2_TOUCH=y
CONFIG_INTERPRETERS_BERRY_LVGL_P2_RAW_X_LEFT=297
CONFIG_INTERPRETERS_BERRY_LVGL_P2_RAW_X_RIGHT=1764
CONFIG_INTERPRETERS_BERRY_LVGL_P2_RAW_Y_TOP=216
CONFIG_INTERPRETERS_BERRY_LVGL_P2_RAW_Y_BOTTOM=1812
CONFIG_INTERPRETERS_BERRY_LVGL_P2_CAL_MARGIN=24
CONFIG_INTERPRETERS_BERRY_LVGL_P2_PRESSURE_MIN=64

CONFIG_EXAMPLES_P2LVGL=y
CONFIG_EXAMPLES_P2LVGL_PRIORITY=100
CONFIG_EXAMPLES_P2LVGL_STACKSIZE=16384
CONFIG_EXAMPLES_P2LVGL_RAW_X_LEFT=297
CONFIG_EXAMPLES_P2LVGL_RAW_X_RIGHT=1764
CONFIG_EXAMPLES_P2LVGL_RAW_Y_TOP=216
CONFIG_EXAMPLES_P2LVGL_RAW_Y_BOTTOM=1812
CONFIG_EXAMPLES_P2LVGL_CAL_MARGIN=24
CONFIG_EXAMPLES_P2LVGL_PRESSURE_MIN=100

# CONFIG_SYSTEM_DD is not set
```

## boards/p2/p2x8c4m64p/p2-ec32mb/configs/ostest-pi-production/defconfig
```kconfig
CONFIG_ARCH="p2"
CONFIG_ARCH_P2=y
CONFIG_ARCH_CHIP="p2x8c4m64p"
CONFIG_ARCH_CHIP_P2X8C4M64P=y
CONFIG_ARCH_BOARD="p2-ec32mb"
CONFIG_ARCH_BOARD_P2_EC32MB=y
CONFIG_ARCH_TOOLCHAIN_CLANG=y
CONFIG_BUILD_FLAT=y
CONFIG_CANCELLATION_POINTS=y
CONFIG_DEBUG_FEATURES=y
CONFIG_DEBUG_FULLOPT=y
CONFIG_DEFAULT_TASK_STACKSIZE=4096
CONFIG_DEV_CONSOLE=y
CONFIG_DEV_NULL=y
CONFIG_DISABLE_MQUEUE_SYSV=y
CONFIG_ENABLE_ALL_SIGNALS=y
CONFIG_FS_NAMED_SEMAPHORES=y
CONFIG_HRTIMER=y
CONFIG_HRTIMER_LIST=y
CONFIG_IDLETHREAD_STACKSIZE=2048
CONFIG_INIT_ENTRYPOINT="ostest_main"
CONFIG_INTELHEX_BINARY=n
CONFIG_LIBC_ARCH_ATOMIC=y
CONFIG_LIBC_RAND_ORDER=0
CONFIG_LIBM_NONE=y
CONFIG_P2_BOOT_TRACE=y
CONFIG_PREALLOC_CHILDSTATUS=16
CONFIG_PREALLOC_MQ_MSGS=16
CONFIG_PREALLOC_TIMERS=8
CONFIG_PRIORITY_INHERITANCE=y
CONFIG_PTHREAD_MUTEX_BOTH=y
CONFIG_PTHREAD_MUTEX_DEFAULT_PRIO_INHERIT=y
CONFIG_PTHREAD_MUTEX_TYPES=y
CONFIG_PTHREAD_STACK_DEFAULT=4096
CONFIG_RAM_SIZE=524288
CONFIG_RAW_BINARY=y
CONFIG_RR_INTERVAL=200
CONFIG_SCHED_CHILD_STATUS=y
CONFIG_SCHED_EVENTS=y
CONFIG_SCHED_HAVE_PARENT=y
CONFIG_SCHED_LPWORK=y
CONFIG_SCHED_LPWORKSTACKSIZE=4096
CONFIG_SCHED_SPORADIC=y
CONFIG_SCHED_SPORADIC_MAXREPL=5
CONFIG_SCHED_WAITPID=y
CONFIG_SEM_PREALLOCHOLDERS=8
CONFIG_SIG_DEFAULT=y
CONFIG_SIG_EVTHREAD=y
CONFIG_STACK_COLORATION=y
CONFIG_STACK_USAGE=y
CONFIG_START_DAY=1
CONFIG_START_MONTH=1
CONFIG_START_YEAR=2026
CONFIG_TESTING_OSTEST=y
CONFIG_TESTING_OSTEST_LOOPS=1
CONFIG_TESTING_OSTEST_RR_RANGE=3000
CONFIG_TESTING_OSTEST_STACKSIZE=8192
CONFIG_TESTING_OSTEST_WAITRESULT=y
CONFIG_TLS_NCLEANUP=4
CONFIG_TLS_NELEM=4
CONFIG_UART0_BAUD=230400
CONFIG_UART0_SERIAL_CONSOLE=y
```

## boards/p2/p2x8c4m64p/p2-ec32mb/configs/psram/defconfig
```kconfig
CONFIG_ARCH="p2"
CONFIG_ARCH_P2=y
CONFIG_ARCH_CHIP="p2x8c4m64p"
CONFIG_ARCH_CHIP_P2X8C4M64P=y
CONFIG_ARCH_BOARD="p2-ec32mb"
CONFIG_ARCH_BOARD_P2_EC32MB=y
CONFIG_ARCH_TOOLCHAIN_CLANG=y
CONFIG_BOARDCTL=y
CONFIG_BOARD_LATE_INITIALIZE=y
CONFIG_BUILD_FLAT=y
CONFIG_BUILTIN=y
CONFIG_DEBUG_FEATURES=y
CONFIG_DEV_CONSOLE=y
CONFIG_DISABLE_MQUEUE=y
CONFIG_DISABLE_POSIX_TIMERS=y
CONFIG_INIT_ENTRYPOINT="nsh_main"
CONFIG_INTELHEX_BINARY=n
CONFIG_LIBC_ARCH_ATOMIC=y
CONFIG_LIBM_NONE=y
CONFIG_NFILE_DESCRIPTORS=8
CONFIG_NSH_ARCHINIT=n
CONFIG_NSH_BUILTIN_APPS=y
CONFIG_NSH_FILEIOSIZE=512
CONFIG_NSH_READLINE=y
CONFIG_PREALLOC_TIMERS=2
CONFIG_RAM_SIZE=524288
CONFIG_RAW_BINARY=y
CONFIG_P2_BOOT_TRACE=y
CONFIG_P2_SMARTPIN=y
CONFIG_P2_EC32MB_PSRAM=y
CONFIG_P2_EC32MB_PSRAM_COG_STACKSIZE=3072
CONFIG_P2_EC32MB_PSRAM_MAX_REQUEST=65536
CONFIG_P2_EC32MB_PSRAM_TIMEOUT_TICKS=500
CONFIG_P2_EC32MB_PSRAM_CANCEL_GRACE_TICKS=100
CONFIG_RR_INTERVAL=200
CONFIG_SCHED_HPWORK=n
CONFIG_START_DAY=1
CONFIG_START_MONTH=1
CONFIG_START_YEAR=2026
CONFIG_SYSTEM_NSH=y
CONFIG_TESTING_P2PSRAM=y
CONFIG_TESTING_P2PSRAM_STACKSIZE=4096
CONFIG_TESTING_P2PSRAM_WORKER_STACKSIZE=2048
CONFIG_TESTING_P2PSRAM_RANDOM_COUNT=1024
CONFIG_UART0_BAUD=230400
CONFIG_UART0_SERIAL_CONSOLE=y
CONFIG_USEC_PER_TICK=10000
```

## boards/p2/p2x8c4m64p/p2-ec32mb/configs/python/defconfig
```kconfig
CONFIG_ALLOW_BSD_COMPONENTS=y
CONFIG_ARCH="p2"
CONFIG_ARCH_P2=y
CONFIG_ARCH_CHIP="p2x8c4m64p"
CONFIG_ARCH_CHIP_P2X8C4M64P=y
CONFIG_ARCH_BOARD="p2-ec32mb"
CONFIG_ARCH_BOARD_P2_EC32MB=y
CONFIG_ARCH_TOOLCHAIN_CLANG=y
CONFIG_BOARDCTL=y
CONFIG_BOARDCTL_ROMDISK=y
CONFIG_BOARD_LATE_INITIALIZE=y
CONFIG_BUILD_FLAT=y
CONFIG_BUILTIN=y
CONFIG_CRYPTO=y
CONFIG_DEBUG_FEATURES=y
CONFIG_DEFAULT_SMALL=y
CONFIG_DEV_CONSOLE=y
CONFIG_DEV_RANDOM=y
CONFIG_DEV_URANDOM=y
CONFIG_DEV_URANDOM_ARCH=y
# CONFIG_DISABLE_ENVIRON is not set
CONFIG_DISABLE_MQUEUE=y
# CONFIG_DISABLE_PTHREAD is not set
CONFIG_DISABLE_POSIX_TIMERS=y
CONFIG_ENABLE_ALL_SIGNALS=y
CONFIG_EVENT_FD=y
CONFIG_EXPERIMENTAL=y
CONFIG_FILE_STREAM=y
CONFIG_FS_HEAPSIZE=1048576
CONFIG_FS_HEAP_USER_BUFFER=y
CONFIG_FS_ROMFS=y
CONFIG_FS_TMPFS=y
CONFIG_INIT_ENTRYPOINT="nsh_main"
CONFIG_INTELHEX_BINARY=n
CONFIG_INTERPRETERS_CPYTHON=y
CONFIG_INTERPRETERS_CPYTHON_EXTERNAL_ROMFS=y
CONFIG_INTERPRETERS_CPYTHON_ROMFS_SECTORSIZE=512
CONFIG_INTERPRETERS_CPYTHON_STACKSIZE=24576
# CONFIG_INTERPRETERS_CPYTHON_ENABLE_PIP is not set
# CONFIG_INTERPRETERS_CPYTHON_INSTALL_NUTTX_PACKAGE is not set
CONFIG_LIBC_ARCH_ATOMIC=y
CONFIG_LIBC_EXECFUNCS=y
CONFIG_LIBC_LOCALE=y
CONFIG_LIBC_LOCALE_GETTEXT=y
CONFIG_LIBC_PERROR_STDOUT=y
CONFIG_LIBC_STRERROR=y
CONFIG_LIBC_TEMPBUFFER=y
CONFIG_LIBM_NEWLIB=y
CONFIG_LIB_ZLIB=y
CONFIG_LINE_MAX=256
CONFIG_MM_KERNEL_HEAP=y
CONFIG_MM_KERNEL_HEAPSIZE=65536
CONFIG_MM_REGIONS=2
CONFIG_NAME_MAX=64
CONFIG_NFILE_DESCRIPTORS_PER_BLOCK=8
CONFIG_NSH_ARCHINIT=n
CONFIG_NSH_BUILTIN_APPS=y
# CONFIG_NSH_DISABLEBG is not set
# CONFIG_NSH_DISABLE_ECHO is not set
# CONFIG_NSH_DISABLE_MKDIR is not set
# CONFIG_NSH_DISABLE_MOUNT is not set
CONFIG_NSH_FILEIOSIZE=512
CONFIG_NSH_READLINE=y
CONFIG_P2_BOOT_TRACE=y
CONFIG_P2_EC32MB_PSRAM_UNIFIED=y
CONFIG_P2_EC32MB_PSRAM_UNIFIED_RESERVE_SIZE=16777216
CONFIG_P2_HUB_OVERLAYS=y
CONFIG_P2_HUB_OVERLAY_GROUP_COUNT=512
CONFIG_P2_HUB_OVERLAY_LIBM=y
CONFIG_P2_HUB_OVERLAY_SLOT_SIZE=90112
CONFIG_P2_HUB_OVERLAY_ZLIB=y
CONFIG_P2_RNG_BLAKE2S=y
CONFIG_P2_SMARTPIN=y
CONFIG_PIPES=y
CONFIG_PREALLOC_TIMERS=2
# CONFIG_DISABLE_PSEUDOFS_OPERATIONS is not set
CONFIG_PSEUDOFS_SOFTLINKS=y
CONFIG_PTHREAD_MUTEX_TYPES=y
CONFIG_RAM_SIZE=524288
# CONFIG_RAW_BINARY is not set
CONFIG_RR_INTERVAL=200
CONFIG_SCHED_HAVE_PARENT=y
CONFIG_SCHED_HPWORK=n
CONFIG_IRQ_NWORKS=1
CONFIG_SCHED_WAITPID=y
CONFIG_SERIAL_TERMIOS=y
CONFIG_STACK_COLORATION=y
CONFIG_START_DAY=1
CONFIG_START_MONTH=1
CONFIG_START_YEAR=2026
# CONFIG_SYSTEM_DD is not set
CONFIG_SYSTEM_NSH=y
CONFIG_TIMER_FD=y
CONFIG_TLS_NELEM=16
CONFIG_TLS_TASK_NELEM=8
CONFIG_UART0_BAUD=230400
CONFIG_UART0_RXBUFSIZE=2048
CONFIG_UART0_SERIAL_CONSOLE=y
CONFIG_USEC_PER_TICK=10000
```
